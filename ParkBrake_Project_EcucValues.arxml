AUTOSAR XML (schema 4-2-2)
package /ETAS_Project/EcucModuleConfigurationValuess
  module config ComM: implementation-config-variant=VARIANT-PRE-COMPILE
    ComMConfigSet
      Can_Network_Channel_Can_Network (ComMChannel):
        ComMNoCom = true
        ComMFullCommRequestNotificationEnabled = false
        ComMMainFunctionPeriod = 0.01
        ComMBusType = COMM_BUS_TYPE_CAN
        ComMNoWakeUpInhibitionNvmStorage = false
        ComMNoWakeup = true
        ComMNetworkManagement: ComMNmVariant=NONE, ComMNmLightTimeout=10, ComMPncNmRequest=false
        ComMUserPerChannel_Can_Network_Channel_Can_Network (ComMUserPerChannel): ComMUserChannel=ComMUser_Can_Network_Channel_Can_Network
      ComMUser_Can_Network_Channel_Can_Network (ComMUser)
    ComMGeneral:
      ComMResetAfterForcingNoComm = false
      ComMModeLimitationEnabled = false
      ComMPncGatewayEnabled = false
      ComMNmPassiveModeEnable = true
      ComMEcuGroupClassification = 0
      ComMDevErrorDetect = false
      ComMWakeupInhibitionEnabled = false
      ComMPncSupport = false
      ComMTMinFullComModeDuration = 0.01
      ComMVersionInfoApi = false
      ComMRteEnabled = false
      ComMSynchronousWakeUp = false
  module config EcuC: implementation-config-variant=VARIANT-PRE-COMPILE
    EcucConfigSet
      EcucPduCollection: PduIdTypeEnum=uint16, PduLengthTypeEnum=uint16
        4 x Pdu, all with PduLength=1:
          ParkControl_CanIf2PduR_Can_Network_Channel_CAN: SysTPduToPduTriggeringRef=PduTrig_ParkControl
          ParkControl_PduR2Com_Can_Network_Channel_CAN: SysTPduToPduTriggeringRef=PduTrig_ParkControl
          ParkStatus_Com2PduR_Can_Network_Channel_CAN: SysTPduToPduTriggeringRef=PduTrig_ParkStatus
          ParkStatus_PduR2CanIf_Can_Network_Channel_CAN: SysTPduToPduTriggeringRef=PduTrig_ParkStatus
    EcuCRbSettings: EcuCRbRteInUse=true, EcuCRbArRelease=AR42_Rev2
  module config PduR: implementation-config-variant=VARIANT-PRE-COMPILE
    PduRRoutingTables: PduRConfigurationId=0
      PduRRoutingTable
        ParkControl_CanIf2Com_Can_Network_Channel_CAN (PduRRoutingPath)
          ParkControl_PduR2Com_Can_Network_Channel_CAN (PduRDestPdu): PduRDestPduRef=EcucPduCollection/ParkControl_PduR2Com_Can_Network_Channel_CAN
          ParkControl_CanIf2PduR_Can_Network_Channel_CAN (PduRSrcPdu): PduRSrcPduRef=EcucPduCollection/ParkControl_CanIf2PduR_Can_Network_Channel_CAN
        ParkStatus_Com2CanIf_Can_Network_Channel_CAN (PduRRoutingPath)
          ParkStatus_Com2PduR_Can_Network_Channel_CAN (PduRSrcPdu): PduRSrcPduRef=EcucPduCollection/ParkStatus_Com2PduR_Can_Network_Channel_CAN
          ParkStatus_PduR2CanIf_Can_Network_Channel_CAN (PduRDestPdu): PduRDestPduRef=EcucPduCollection/ParkStatus_PduR2CanIf_Can_Network_Channel_CAN
    CanIf (PduRBswModules):
      PduRUpperModule = false
      PduRTriggertransmit = false
      PduRRetransmission = false
      PduRCommunicationInterface = true
      PduRUseTag = false
      PduRTransportProtocol = false
      PduRCancelTransmit = false
      PduRLowerModule = true
      PduRCancelReceive = false
      PduRTxConfirmation = true
      PduRChangeParameterApi = false
      PduRBswModuleRef = CanIf
    Com (PduRBswModules):
      PduRUpperModule = true
      PduRTriggertransmit = true
      PduRRetransmission = false
      PduRCommunicationInterface = true
      PduRUseTag = false
      PduRTransportProtocol = true
      PduRCancelTransmit = false
      PduRLowerModule = false
      PduRCancelReceive = false
      PduRTxConfirmation = false
      PduRChangeParameterApi = false
      PduRBswModuleRef = Com
    PduRGeneral:
      PduRTPGatewayOperation = false
      PduRVersionInfoApi = false
      PduRMulticastFromTpSupport = false
      PduRZeroCostOperation = false
      PduRDevErrorDetect = false
      PduRMulticastToTpSupport = false
      PduRQueueingSupport = false
      PduRMulticastToIfSupport = false
      PduRIFGatewayOperation = false
      PduRGwTpWithLimitedBuffer = false
  module config Com: implementation-config-variant=VARIANT-PRE-COMPILE
    ComConfig
      ComTimeBase: ComTxTimeBase=0.01, ComRxTimeBase=0.01, ComGwTimeBase=0.005
      IP_ParkControl_Can_Network_Channel_CAN_Rx (ComIPdu):
        ComIPduDirection = RECEIVE
        ComIPduSignalProcessing = IMMEDIATE
        ComIPduType = NORMAL
        ComIPduSignalRef = S_ParkControl_bool_Can_Network_Channel_CAN_Rx
        ComIPduGroupRef = ComIPduGroup_Rx
        ComPduIdRef = EcucPduCollection/ParkControl_PduR2Com_Can_Network_Channel_CAN
      S_ParkControl_bool_Can_Network_Channel_CAN_Rx (ComSignal):
        ComNotification = Rte_COMCbk_S_ParkControl_bool_Can_Network_Channel_CAN_Rx
        ComSignalType = UINT8
        ComSignalEndianness = LITTLE_ENDIAN
        ComBitSize = 1
        ComTransferProperty = TRIGGERED
        ComBitPosition = 0
        ComTimeoutNotification = Rte_COMCbkTOut_S_ParkControl_bool_Can_Network_Channel_CAN_Rx
        ComSystemTemplateSystemSignalRef = ParkControl_bool
      IP_ParkStatus_Can_Network_Channel_CAN_Tx (ComIPdu):
        ComIPduDirection = SEND
        ComTimeout = 0.1
        ComIPduSignalProcessing = IMMEDIATE
        ComIPduType = NORMAL
        ComFirstTimeout = 0.1
        ComIPduSignalRef = S_ParkStatus_bool_Can_Network_Channel_CAN_Tx
        ComIPduGroupRef = ComIPduGroup_Tx
        ComPduIdRef = EcucPduCollection/ParkStatus_Com2PduR_Can_Network_Channel_CAN
        ComTxIPdu: ComTxIPduUnusedAreasDefault=255
          ComTxModeTrue
            ComTxMode: ComTxModeNumberOfRepetitions=0, ComTxModeMode=PERIODIC, ComTxModeTimeOffset=0.0, ComTxModeTimePeriod=0.1, ComTxModeRepetitionPeriod=0
          ComTxModeFalse
            ComTxMode: ComTxModeNumberOfRepetitions=0, ComTxModeMode=PERIODIC, ComTxModeTimeOffset=0.0, ComTxModeTimePeriod=0.1, ComTxModeRepetitionPeriod=0
      S_ParkStatus_bool_Can_Network_Channel_CAN_Tx (ComSignal):
        ComSignalType = UINT8
        ComSignalEndianness = LITTLE_ENDIAN
        ComBitSize = 1
        ComTransferProperty = TRIGGERED
        ComInitialValueOnly = false
        ComBitPosition = 0
        ComSystemTemplateSystemSignalRef = ParkStatus_bool
        ComFilter: ComFilterAlgorithm=ALWAYS, ComFilterMin=0, ComFilterMax=1, ComFilterOffset=0
      ComIPduGroup_Rx (ComIPduGroup)
      ComIPduGroup_Tx (ComIPduGroup)
    ComGeneral:
      ComCancellationSupport = false
      ComEnableJitterFilter = false
      ComCommonIPduTxPeriodFeature = false
      ComVersionInfoApi = false
      ComEnableSignalGroupArrayApi = false
      ComConfigurationUseDet = false
  module config Can: implementation-config-variant=VARIANT-PRE-COMPILE
    CanConfigSet
      Can_Network_CANNODE_0 (CanController):
        CanRxProcessing = POLLING
        CanControllerId = 0
        CanWakeupProcessing = POLLING
        CanControllerBaseAddress = 0
        CanTxProcessing = POLLING
        CanBusoffProcessing = POLLING
        CanControllerActivation = true
        CanWakeupFunctionalityAPI = false
        CanWakeupSupport = false
        HardwareNameWin = BOACan1
        CanControllerDefaultBaudrate = Can_Network_CANNODE_0_BR_0
        Can_Network_CANNODE_0_BR_0 (CanControllerBaudrateConfig):
          CanControllerBaudRate = 500
          CanControllerBaudRateConfigID = 1
          CanControllerSeg1 = 10
          CanControllerSyncJumpWidth = 0
          CanControllerSeg2 = 0
          CanControllerPropSeg = 0
      Can_Network_CANNODE_0_Rx_Std_MailBox_1 (CanHardwareObject): CanHandleType=FULL, CanObjectId=0, CanObjectType=RECEIVE, CanHwObjectCount=1, CanIdType=STANDARD, CanControllerRef=CanConfigSet/Can_Network_CANNODE_0
        CanHwFilter: CanHwFilterMask=2047, CanHwFilterCode=186
      Can_Network_CANNODE_0_Tx_Std_MailBox_1 (CanHardwareObject): CanHandleType=FULL, CanObjectId=1, CanObjectType=TRANSMIT, CanHwObjectCount=1, CanIdType=STANDARD, CanControllerRef=CanConfigSet/Can_Network_CANNODE_0
        CanHwFilter: CanHwFilterCode=0, CanHwFilterMask=0
    CanGeneral:
      CanIndex = 0
      CanMultiplexedTransmission = false
      CanMainFunctionModePeriod = 0.001
      CanVersionInfoApi = false
      CanMainFunctionBusoffPeriod = 0.001
      CanDevErrorDetection = false
      CanPublicIcomSupport = false
      CanTimeoutDuration = 1
      CanMainFunctionRWPeriods: CanMainFunctionPeriod=0.01
  module config CanIf: implementation-config-variant=VARIANT-PRE-COMPILE
    CanIfCtrlDrvCfg: CanIfRbCtrlDrvPrefix=CanConf_CanHardwareObject, CanIfCtrlDrvNameRef=CanGeneral, CanIfCtrlDrvInitHohConfigRef=CanIfInitHohCfg
      Can_Network_CANNODE_0 (CanIfCtrlCfg): CanIfCtrlWakeupSupport=false, CanIfCtrlCanCtrlRef=CanConfigSet/Can_Network_CANNODE_0
    CanIfInitCfg: CanIfInitCfgSet=0
      CanIfInitHohCfg
        Can_Network_CANNODE_0_Rx_Std_MailBox_1 (CanIfHrhCfg): CanIfHrhIdSymRef=CanConfigSet/Can_Network_CANNODE_0_Rx_Std_MailBox_1, CanIfHrhCanCtrlIdRef=CanIfCtrlDrvCfg/Can_Network_CANNODE_0
        Can_Network_CANNODE_0_Tx_Std_MailBox_1 (CanIfHthCfg): CanIfHthCanCtrlIdRef=CanIfCtrlDrvCfg/Can_Network_CANNODE_0, CanIfHthIdSymRef=CanConfigSet/Can_Network_CANNODE_0_Tx_Std_MailBox_1
      ParkControl_Can_Network_CANNODE_0_IN (CanIfRxPduCfg):
        CanIfRxPduUserRxIndicationUL = PDUR
        CanIfRxPduDlc = 1
        CanIfRxPduCanId = 186
        CanIfRxPduCanIdType = STANDARD_CAN
        CanIfRxPduReadData = false
        CanIfRxPduReadNotifyStatus = true
        CanIfRxPduUserRxIndicationName = PduR_CanIfRxIndication
        CanIfRxPduRef = EcucPduCollection/ParkControl_CanIf2PduR_Can_Network_Channel_CAN
        CanIfRxPduHrhIdRef = CanIfInitHohCfg/Can_Network_CANNODE_0_Rx_Std_MailBox_1
      ParkStatus_Can_Network_CANNODE_0_OUT (CanIfTxPduCfg):
        CanIfTxPduUserTxConfirmationName = PduR_CanIfTxConfirmation
        CanIfTxPduReadNotifyStatus = false
        CanIfTxPduUserTxConfirmationUL = PDUR
        CanIfTxPduCanId = 171
        CanIfTxPduCanIdType = STANDARD_CAN
        CanIfTxPduTruncation = false
        CanIfTxPduType = STATIC
        CanIfTxPduRef = EcucPduCollection/ParkStatus_PduR2CanIf_Can_Network_Channel_CAN
        CanIfTxPduBufferRef = Bu_Can_Network_CANNODE_0_Tx_Std_MailBox_1
      Bu_Can_Network_CANNODE_0_Tx_Std_MailBox_1 (CanIfBufferCfg): CanIfBufferSize=0, CanIfBufferHthRef=CanIfInitHohCfg/Can_Network_CANNODE_0_Tx_Std_MailBox_1
    CanIfPublicCfg:
      CanIfPublicWakeupCheckValidSupport = false
      CanIfPublicDevErrorDetect = false
      CanIfPublicErrorPassiveSupport = false
      CanIfPublicBusoffRecoveryfromRxIndication = false
      CanIfPublicTxBuffering = false
      CanIfPublicReadTxPduNotifyStatusApi = true
      CanIfPublicVersionInfoApi = false
      CanIfPublicCanIfLiteConfiguration = false
      CanIfPublicTxConfirmPollingSupport = false
      CanIfTxOfflineActiveSupport = false
      CanIfPublicCancelTransmitSupport = false
      CanIfPublicReadRxPduNotifyStatusApi = true
      CanIfWakeupSupport = false
      CanIfTriggerTransmitSupport = false
      CanIfPublicSetDynamicTxIdApi = false
      CanIfPublicMultipleDrvSupport = false
      CanIfPublicPnSupport = false
      CanIfPublicReadRxPduDataApi = false
      CanIfPublicUserTpTxInOfflineMode = false
      CanIfRbCalibrationSupport: CanIfRbCalibration=false
    CanIfDispatchCfg: CanIfDispatchUserTrcvModeIndicationName=CAN_SM, CanIfDispatchUserCtrlBusOffUL=CAN_SM, CanIfDispatchUserCtrlModeIndicationUL=CAN_SM
    CanIfPrivateCfg: CanIfPrivateDlcCheck=false
  module config CanSM: implementation-config-variant=VARIANT-PRE-COMPILE
    CanSMConfiguration: CanSMModeRequestRepetitionMax=5, CanSMModeRequestRepetitionTime=0.07
      Can_Network_CANNODE_0 (CanSMManagerNetwork):
        CanSMBorCounterL1ToL2 = 0
        CanSMBorTimeL1 = 0.04
        CanSMBorTimeL2 = 0.1
        CanSMBorTimeTxEnsured = 0.02
        CanSMBorTxConfirmationPolling = false
        CanSMComMNetworkHandleRef = Can_Network_Channel_Can_Network
        Can_Network_CANNODE_0 (CanSMController): CanSMControllerId=CanIfCtrlDrvCfg/Can_Network_CANNODE_0
        CanSMDemEventParameterRefs: CanSMRbDynCreate_CANSM_E_BUS_OFF=Standard
    CanSMGeneral: CanSMMainFunctionTimePeriod=0.01, CanSMDevErrorDetect=false, CanSMVersionInfoApi=false
  module config NvM: implementation-config-variant=VARIANT-PRE-COMPILE
    NvMCommon:
      NvMJobPrioritization = false
      NvMSizeStandardJobQueue = 1
      NvMBswMMultiBlockJobStatusInformation = true
      NvMDevErrorDetect = false
      NvMDynamicConfiguration = false
      NvMCrcNumOfBytes = 1
      NvMDrvModeSwitch = false
      NvMMainFunctionPeriod = 0.001
      NvMMultiBlockCallback = NULL_PTR
      NvMVersionInfoApi = false
      NvMSetRamBlockStatusApi = true
      NvMPollingMode = true
      NvMCompiledConfigId = 2
      NvMApiConfigClass = NVM_API_CONFIG_CLASS_3
    3 x NvMBlockDescriptor, all with NvMStaticBlockIDCheck=false, NvMWriteVerification=false, NvMMaxNumOfReadRetries=0, NvMBlockUseSyncMechanism=false, NvMBlockWriteProt=false, NvMNvBlockNum=1, NvMCalcRamBlockCrc=false, NvMBlockManagementType=NVM_BLOCK_NATIVE, NvMWriteBlockOnce=false, NvMRomBlockNum=0, NvMBlockJobPriority=1, NvMResistantToChangedSw=false, NvMInitBlockCallback=NULL_PTR, NvMMaxNumOfWriteRetries=0, NvMNvramDeviceId=0, NvMWriteVerificationDataSize=0:
      NvM_MultiBlock: NvMBlockUseCrc=true, NvMBlockCrcType=NVM_CRC16, NvMNvBlockLength=1
      NvM_ConfigId: NvMSelectBlockForReadAll=true, NvMBlockUseCrc=true, NvMBlockCrcType=NVM_CRC16, NvMNvBlockLength=2, NvMRamBlockDataAddress=NvM_Prv_idConfigStored_u16, NvMSelectBlockForWriteAll=true
      NvM_NativeBlock_2: NvMRbSelectBlockForFirstInitAll=false, NvMRbGenRteServicePort=true, NvMRamBlockDataAddress=Rte_CPim_MemSWC_ParkStatus, NvMSelectBlockForWriteAll=true, NvMBlockUseAutoValidation=false, NvMSelectBlockForReadAll=true, NvMBlockCrcType=NVM_CRC32, NvMBlockUseCrc=false, NvMRbGenRteAdminPort=false, NvMNvBlockLength=1
  module config MemIf: implementation-config-variant=VARIANT-PRE-COMPILE
    MemIfGeneral: MemIfVersionInfoApi=false, MemIfDevErrorDetect=false
  module config rba_MemLib: implementation-config-variant=PRECONFIGURED-CONFIGURATION
    rba_MemLibCentral: rba_MemLibCentralEnablePrototype=false, rba_MemLibVersionInfoApi=false
  module config Fee: implementation-config-variant=VARIANT-PRE-COMPILE
    FeeGeneral:
      FeeVirtualPageSize = 8
      FeeSetModeSupported = false
      FeeDevErrorDetect = false
      FeeRbMachineType = MCU_RB_EVE_AUTOSAR
      FeeVersionInfoApi = false
      FeePollingMode = true
      FeeIndex = 0
      FeeRbConfirmSingleStorageBlockloss = true
    FeePublishedInformation
