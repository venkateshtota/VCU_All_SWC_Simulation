AUTOSAR XML (schema 4-2-2)
standard types defined: uint8, boolean
package /AUTOSAR_Rte/BswModuleDescriptions
  bsw module description Rte: outgoing-callbacks=[Rte_StartHook_Return, Rte_StartHook_Start, Rte_StopHook_Return, Rte_StopHook_Start, Rte_Task_Activate]
    provided-entrys:
      Rte_ActivateRE
      Rte_Call_MemSWC_RP_NvM_ParkStatus_ReadBlock
      Rte_Call_MemSWC_RP_NvM_ParkStatus_SetRamBlockStatus
      Rte_Call_MemSWC_RP_NvM_ParkStatus_WriteBlock
      Rte_Call_ParkSWC_RP_DioControl_DioActuate
      Rte_Call_SystemSWC_RP_KeyStatus_KeyStatus
      Rte_DecrementWaitingCount
      Rte_GetCurrentTaskIndex
      Rte_MainFunction
      Rte_Mode_BswM_RP_BswM_MRP_SwcModeRequest_MDGP_MSI_ShutDown
      Rte_ReadQueue
      Rte_Read_ComSWC_RP_ParkStatus_DE_ParkState
      Rte_Read_ComSWC_RP_comParkControl_DE_ParkState
      Rte_Read_MemSWC_RP_ParkStatus_DE_ParkState
      Rte_Read_ParkSWC_RP_ParkControl_DE_ParkState
      Rte_SetEvent
      Rte_Start
      Rte_Stop
      Rte_Switch_SystemSWC_PP_ShutdownRequest_MDGP_MSI_ShutDown
      Rte_WaitWithTimeout
      Rte_WriteQueue
      Rte_Write_ComSWC_PP_ParkControl_DE_ParkState
      Rte_Write_ComSWC_PP_comParkStatus_DE_ParkState
      Rte_Write_ParkSWC_PP_ParkStatus_DE_ParkState
      Rte_memcpy
      SchM_Deinit
      SchM_IModeInit
      SchM_Init
      SchM_Mode_BswM_MDGR_BswM_MRP_BswM_MDG
      SchM_Switch_BswM_MDGP_AUTOSAR_BswM_ModeDeclarationGroups_MDG_ECUM_STATE
    bsw module dependency AUTOSAR_Os: target-module-id=1
    bsw module dependency AUTOSAR_Com: target-module-id=50
    bsw internal behavior RteInternalBehavior
      constant-memorys:
        17 x parameter data prototype:
          Rte_Inst_BswM: type=Rte_CDS_BswM
          Rte_Inst_ComM: type=Rte_CDS_ComM
          Rte_Inst_ComSWC: type=Rte_CDS_ComSWC
          Rte_Inst_EcuM: type=Rte_CDS_EcuM
          Rte_Inst_MemSWC: type=Rte_CDS_MemSWC
          Rte_Inst_NvM: type=Rte_CDS_NvM
          Rte_Inst_ParkSWC: type=Rte_CDS_ParkSWC
          Rte_Inst_SystemSWC: type=Rte_CDS_SystemSWC
          Rte_Self_CPT_ComSWC: type=Rte_SelfType_ComSWC
          Rte_Self_CPT_MemSWC: type=Rte_SelfType_MemSWC
          Rte_Self_CPT_ParkSWC: type=Rte_SelfType_ParkSWC
          Rte_Self_CPT_SystemSWC: type=Rte_SelfType_SystemSWC
          Rte_Self_SWCI4: type=Rte_SelfType_ComM
          Rte_Self_SWCI5: type=Rte_SelfType_NvM
          Rte_Self_SWCI6: type=Rte_SelfType_EcuM
          Rte_Self_SWCI7: type=Rte_SelfType_BswM
          Rte_Tasks: type=Rte_TaskInfo
      static-memorys:
        12 x data:
          Rte_ActCount_CPT_MemSWC_DRE_RE_MemSWC_StoreData: type=Rte_REActCounterType
          Rte_ActCount_CPT_ParkSWC_DRE_RE_ParkSWC_main: type=Rte_REActCounterType
          Rte_CPim_MemSWC_ParkStatus: type=Rte_PimType_MemSWC_parkStatus
          Rte_ModeCurrent_0: type=uint8
          Rte_ModeCurrent_1: type=uint8
          Rte_ModeNext_1: type=uint8
          Rte_ModeSchMNext_0: type=uint8
          Rte_RECount_OsTask_ASW_PeriodicEvents_divby2_0: type=uint8
          Rte_RECount_OsTask_BSW_divby10_0: type=uint8
          Rte_Rx_{000000..000002}: type=boolean
      30 x bsw called entity, all with sw-addr-method=CODE:
        Rte_ActivateRE: implemented-entry=Rte_ActivateRE
        Rte_Call_MemSWC_RP_NvM_ParkStatus_ReadBlock: implemented-entry=Rte_Call_MemSWC_RP_NvM_ParkStatus_ReadBlock
        Rte_Call_MemSWC_RP_NvM_ParkStatus_SetRamBlockStatus: implemented-entry=Rte_Call_MemSWC_RP_NvM_ParkStatus_SetRamBlockStatus
        Rte_Call_MemSWC_RP_NvM_ParkStatus_WriteBlock: implemented-entry=Rte_Call_MemSWC_RP_NvM_ParkStatus_WriteBlock
        Rte_Call_ParkSWC_RP_DioControl_DioActuate: implemented-entry=Rte_Call_ParkSWC_RP_DioControl_DioActuate
        Rte_Call_SystemSWC_RP_KeyStatus_KeyStatus: implemented-entry=Rte_Call_SystemSWC_RP_KeyStatus_KeyStatus
        Rte_DecrementWaitingCount: implemented-entry=Rte_DecrementWaitingCount
        Rte_GetCurrentTaskIndex: implemented-entry=Rte_GetCurrentTaskIndex
        Rte_MainFunction: implemented-entry=Rte_MainFunction
        Rte_Mode_BswM_RP_BswM_MRP_SwcModeRequest_MDGP_MSI_ShutDown: implemented-entry=Rte_Mode_BswM_RP_BswM_MRP_SwcModeRequest_MDGP_MSI_ShutDown
        Rte_ReadQueue: implemented-entry=Rte_ReadQueue
        Rte_Read_ComSWC_RP_ParkStatus_DE_ParkState: implemented-entry=Rte_Read_ComSWC_RP_ParkStatus_DE_ParkState
        Rte_Read_ComSWC_RP_comParkControl_DE_ParkState: implemented-entry=Rte_Read_ComSWC_RP_comParkControl_DE_ParkState
        Rte_Read_MemSWC_RP_ParkStatus_DE_ParkState: implemented-entry=Rte_Read_MemSWC_RP_ParkStatus_DE_ParkState
        Rte_Read_ParkSWC_RP_ParkControl_DE_ParkState: implemented-entry=Rte_Read_ParkSWC_RP_ParkControl_DE_ParkState
        Rte_SetEvent: implemented-entry=Rte_SetEvent
        Rte_Start: implemented-entry=Rte_Start
        Rte_Stop: implemented-entry=Rte_Stop
        Rte_Switch_SystemSWC_PP_ShutdownRequest_MDGP_MSI_ShutDown: implemented-entry=Rte_Switch_SystemSWC_PP_ShutdownRequest_MDGP_MSI_ShutDown
        Rte_WaitWithTimeout: implemented-entry=Rte_WaitWithTimeout
        Rte_WriteQueue: implemented-entry=Rte_WriteQueue
        Rte_Write_ComSWC_PP_ParkControl_DE_ParkState: implemented-entry=Rte_Write_ComSWC_PP_ParkControl_DE_ParkState
        Rte_Write_ComSWC_PP_comParkStatus_DE_ParkState: implemented-entry=Rte_Write_ComSWC_PP_comParkStatus_DE_ParkState
        Rte_Write_ParkSWC_PP_ParkStatus_DE_ParkState: implemented-entry=Rte_Write_ParkSWC_PP_ParkStatus_DE_ParkState
        Rte_memcpy: implemented-entry=Rte_memcpy
        SchM_Deinit: implemented-entry=SchM_Deinit
        SchM_IModeInit: implemented-entry=SchM_IModeInit
        SchM_Init: implemented-entry=SchM_Init
        SchM_Mode_BswM_MDGR_BswM_MRP_BswM_MDG: implemented-entry=SchM_Mode_BswM_MDGR_BswM_MRP_BswM_MDG
        SchM_Switch_BswM_MDGP_AUTOSAR_BswM_ModeDeclarationGroups_MDG_ECUM_STATE: implemented-entry=SchM_Switch_BswM_MDGP_AUTOSAR_BswM_ModeDeclarationGroups_MDG_ECUM_STATE
package /AUTOSAR_Rte/BswModuleEntrys
  35 x bsw module entry:
    Rte_ActivateRE: call-type=REGULAR
    Rte_Call_MemSWC_RP_NvM_ParkStatus_ReadBlock: call-type=REGULAR
    Rte_Call_MemSWC_RP_NvM_ParkStatus_SetRamBlockStatus: call-type=REGULAR
    Rte_Call_MemSWC_RP_NvM_ParkStatus_WriteBlock: call-type=REGULAR
    Rte_Call_ParkSWC_RP_DioControl_DioActuate: call-type=REGULAR
    Rte_Call_SystemSWC_RP_KeyStatus_KeyStatus: call-type=REGULAR
    Rte_DecrementWaitingCount: call-type=REGULAR
    Rte_GetCurrentTaskIndex: call-type=REGULAR
    Rte_MainFunction: call-type=REGULAR
    Rte_Mode_BswM_RP_BswM_MRP_SwcModeRequest_MDGP_MSI_ShutDown: call-type=REGULAR
    Rte_ReadQueue: call-type=REGULAR
    Rte_Read_ComSWC_RP_ParkStatus_DE_ParkState: call-type=REGULAR
    Rte_Read_ComSWC_RP_comParkControl_DE_ParkState: call-type=REGULAR
    Rte_Read_MemSWC_RP_ParkStatus_DE_ParkState: call-type=REGULAR
    Rte_Read_ParkSWC_RP_ParkControl_DE_ParkState: call-type=REGULAR
    Rte_SetEvent: call-type=REGULAR
    Rte_Start: call-type=REGULAR
    Rte_StartHook_Return: call-type=CALLBACK
    Rte_StartHook_Start: call-type=CALLBACK
    Rte_Stop: call-type=REGULAR
    Rte_StopHook_Return: call-type=CALLBACK
    Rte_StopHook_Start: call-type=CALLBACK
    Rte_Switch_SystemSWC_PP_ShutdownRequest_MDGP_MSI_ShutDown: call-type=REGULAR
    Rte_Task_Activate: call-type=CALLBACK
    Rte_WaitWithTimeout: call-type=REGULAR
    Rte_WriteQueue: call-type=REGULAR
    Rte_Write_ComSWC_PP_ParkControl_DE_ParkState: call-type=REGULAR
    Rte_Write_ComSWC_PP_comParkStatus_DE_ParkState: call-type=REGULAR
    Rte_Write_ParkSWC_PP_ParkStatus_DE_ParkState: call-type=REGULAR
    Rte_memcpy: call-type=REGULAR
    SchM_Deinit: call-type=REGULAR
    SchM_IModeInit: call-type=REGULAR
    SchM_Init: call-type=REGULAR
    SchM_Mode_BswM_MDGR_BswM_MRP_BswM_MDG: call-type=REGULAR
    SchM_Switch_BswM_MDGP_AUTOSAR_BswM_ModeDeclarationGroups_MDG_ECUM_STATE: call-type=REGULAR
package /AUTOSAR_Rte/BswImplementations
  bsw implementation Rte: programming-language=C, sw-version=0.0.0, used-code-generator=ETAS RTEGen, ar-release-version=4.0.0, behavior=RteInternalBehavior
    generated-artifacts:
      63 x dependency on artifact:
        BswM_MemMap_h: artifact-descriptor={short-label=BswM_MemMap_h, category=SWHDR, domain=AUTOSAR}
        Com_h: artifact-descriptor={short-label=Com_h, category=SWHDR, domain=AUTOSAR}
        ComM_MemMap_h: artifact-descriptor={short-label=ComM_MemMap_h, category=SWHDR, domain=AUTOSAR}
        ComSWC_MemMap_h: artifact-descriptor={short-label=ComSWC_MemMap_h, category=SWHDR, domain=AUTOSAR}
        EcuM_MemMap_h: artifact-descriptor={short-label=EcuM_MemMap_h, category=SWHDR, domain=AUTOSAR}
        Ioc_h: artifact-descriptor={short-label=Ioc_h, category=SWHDR, domain=AUTOSAR}
        MemSWC_MemMap_h: artifact-descriptor={short-label=MemSWC_MemMap_h, category=SWHDR, domain=AUTOSAR}
        NvM_h: artifact-descriptor={short-label=NvM_h, category=SWHDR, domain=AUTOSAR}
        NvM_MemMap_h: artifact-descriptor={short-label=NvM_MemMap_h, category=SWHDR, domain=AUTOSAR}
        Os_h: artifact-descriptor={short-label=Os_h, category=SWHDR, domain=AUTOSAR}
        OsTask_ASW_PeriodicEvents_h: artifact-descriptor={short-label=OsTask_ASW_PeriodicEvents_h, category=SWHDR, domain=AUTOSAR}
        OsTask_ASW_SporadicEvents_h: artifact-descriptor={short-label=OsTask_ASW_SporadicEvents_h, category=SWHDR, domain=AUTOSAR}
        OsTask_BSW_h: artifact-descriptor={short-label=OsTask_BSW_h, category=SWHDR, domain=AUTOSAR}
        ParkSWC_MemMap_h: artifact-descriptor={short-label=ParkSWC_MemMap_h, category=SWHDR, domain=AUTOSAR}
        Rte_c: artifact-descriptor={short-label=Rte_c, category=SWSRC, domain=AUTOSAR}
        Rte_h: artifact-descriptor={short-label=Rte_h, category=SWHDR, domain=AUTOSAR}
        Rte_BswM_h: artifact-descriptor={short-label=Rte_BswM_h, category=SWHDR, domain=AUTOSAR}
        Rte_BswM_Type_h: artifact-descriptor={short-label=Rte_BswM_Type_h, category=SWHDR, domain=AUTOSAR}
        Rte_Cbk_h: artifact-descriptor={short-label=Rte_Cbk_h, category=SWHDR, domain=AUTOSAR}
        Rte_Cfg_h: artifact-descriptor={short-label=Rte_Cfg_h, category=SWHDR, domain=AUTOSAR}
        Rte_ComM_h: artifact-descriptor={short-label=Rte_ComM_h, category=SWHDR, domain=AUTOSAR}
        Rte_ComM_Type_h: artifact-descriptor={short-label=Rte_ComM_Type_h, category=SWHDR, domain=AUTOSAR}
        Rte_ComSWC_h: artifact-descriptor={short-label=Rte_ComSWC_h, category=SWHDR, domain=AUTOSAR}
        Rte_ComSWC_Type_h: artifact-descriptor={short-label=Rte_ComSWC_Type_h, category=SWHDR, domain=AUTOSAR}
        Rte_Const_h: artifact-descriptor={short-label=Rte_Const_h, category=SWHDR, domain=AUTOSAR}
        Rte_DataHandleType_h: artifact-descriptor={short-label=Rte_DataHandleType_h, category=SWHDR, domain=AUTOSAR}
        Rte_EcuM_h: artifact-descriptor={short-label=Rte_EcuM_h, category=SWHDR, domain=AUTOSAR}
        Rte_EcuM_Type_h: artifact-descriptor={short-label=Rte_EcuM_Type_h, category=SWHDR, domain=AUTOSAR}
        Rte_Hook_h: artifact-descriptor={short-label=Rte_Hook_h, category=SWHDR, domain=AUTOSAR}
        Rte_Intl_h: artifact-descriptor={short-label=Rte_Intl_h, category=SWHDR, domain=AUTOSAR}
        Rte_Lib_c: artifact-descriptor={short-label=Rte_Lib_c, category=SWSRC, domain=AUTOSAR}
        Rte_Main_h: artifact-descriptor={short-label=Rte_Main_h, category=SWHDR, domain=AUTOSAR}
        Rte_MemMap_h: artifact-descriptor={short-label=Rte_MemMap_h, category=SWHDR, domain=AUTOSAR}
        Rte_MemSWC_h: artifact-descriptor={short-label=Rte_MemSWC_h, category=SWHDR, domain=AUTOSAR}
        Rte_MemSWC_Type_h: artifact-descriptor={short-label=Rte_MemSWC_Type_h, category=SWHDR, domain=AUTOSAR}
        Rte_NvM_h: artifact-descriptor={short-label=Rte_NvM_h, category=SWHDR, domain=AUTOSAR}
        Rte_NvM_Type_h: artifact-descriptor={short-label=Rte_NvM_Type_h, category=SWHDR, domain=AUTOSAR}
        Rte_ParkSWC_h: artifact-descriptor={short-label=Rte_ParkSWC_h, category=SWHDR, domain=AUTOSAR}
        Rte_ParkSWC_Type_h: artifact-descriptor={short-label=Rte_ParkSWC_Type_h, category=SWHDR, domain=AUTOSAR}
        Rte_SystemSWC_h: artifact-descriptor={short-label=Rte_SystemSWC_h, category=SWHDR, domain=AUTOSAR}
        Rte_SystemSWC_Type_h: artifact-descriptor={short-label=Rte_SystemSWC_Type_h, category=SWHDR, domain=AUTOSAR}
        Rte_Type_h: artifact-descriptor={short-label=Rte_Type_h, category=SWHDR, domain=AUTOSAR}
        SchM_BswM_h: artifact-descriptor={short-label=SchM_BswM_h, category=SWHDR, domain=AUTOSAR}
        SchM_BswM_Type_h: artifact-descriptor={short-label=SchM_BswM_Type_h, category=SWHDR, domain=AUTOSAR}
        SchM_Can_h: artifact-descriptor={short-label=SchM_Can_h, category=SWHDR, domain=AUTOSAR}
        SchM_CanIf_h: artifact-descriptor={short-label=SchM_CanIf_h, category=SWHDR, domain=AUTOSAR}
        SchM_CanIf_Type_h: artifact-descriptor={short-label=SchM_CanIf_Type_h, category=SWHDR, domain=AUTOSAR}
        SchM_CanSM_h: artifact-descriptor={short-label=SchM_CanSM_h, category=SWHDR, domain=AUTOSAR}
        SchM_CanSM_Type_h: artifact-descriptor={short-label=SchM_CanSM_Type_h, category=SWHDR, domain=AUTOSAR}
        SchM_Can_Type_h: artifact-descriptor={short-label=SchM_Can_Type_h, category=SWHDR, domain=AUTOSAR}
        SchM_Com_h: artifact-descriptor={short-label=SchM_Com_h, category=SWHDR, domain=AUTOSAR}
        SchM_ComM_h: artifact-descriptor={short-label=SchM_ComM_h, category=SWHDR, domain=AUTOSAR}
        SchM_ComM_Type_h: artifact-descriptor={short-label=SchM_ComM_Type_h, category=SWHDR, domain=AUTOSAR}
        SchM_Com_Type_h: artifact-descriptor={short-label=SchM_Com_Type_h, category=SWHDR, domain=AUTOSAR}
        SchM_EcuM_h: artifact-descriptor={short-label=SchM_EcuM_h, category=SWHDR, domain=AUTOSAR}
        SchM_EcuM_Type_h: artifact-descriptor={short-label=SchM_EcuM_Type_h, category=SWHDR, domain=AUTOSAR}
        SchM_MemIf_h: artifact-descriptor={short-label=SchM_MemIf_h, category=SWHDR, domain=AUTOSAR}
        SchM_MemIf_Type_h: artifact-descriptor={short-label=SchM_MemIf_Type_h, category=SWHDR, domain=AUTOSAR}
        SchM_NvM_h: artifact-descriptor={short-label=SchM_NvM_h, category=SWHDR, domain=AUTOSAR}
        SchM_NvM_Type_h: artifact-descriptor={short-label=SchM_NvM_Type_h, category=SWHDR, domain=AUTOSAR}
        SchM_PduR_h: artifact-descriptor={short-label=SchM_PduR_h, category=SWHDR, domain=AUTOSAR}
        SchM_PduR_Type_h: artifact-descriptor={short-label=SchM_PduR_Type_h, category=SWHDR, domain=AUTOSAR}
        SystemSWC_MemMap_h: artifact-descriptor={short-label=SystemSWC_MemMap_h, category=SWHDR, domain=AUTOSAR}
    resource consumption ResConsumption
      23 x memory section:
        RTE_BSWM_CODE: executable-entity=[Rte_Mode_BswM_RP_BswM_MRP_SwcModeRequest_MDGP_MSI_ShutDown, SchM_Mode_BswM_MDGR_BswM_MRP_BswM_MDG, SchM_Switch_BswM_MDGP_AUTOSAR_BswM_ModeDeclarationGroups_MDG_ECUM_STATE], prefix=RTE_BSWM, sw-addrmethod=CODE, symbol=CODE
        RTE_COMSWC_CODE: executable-entity=[Rte_Read_ComSWC_RP_ParkStatus_DE_ParkState, Rte_Read_ComSWC_RP_comParkControl_DE_ParkState, Rte_Write_ComSWC_PP_ParkControl_DE_ParkState, Rte_Write_ComSWC_PP_comParkStatus_DE_ParkState], prefix=RTE_COMSWC, sw-addrmethod=CODE, symbol=CODE
        RTE_EXT_CODE: executable-entity=[Rte_ActivateRE, Rte_SetEvent, Rte_WriteQueue], prefix=RTE_EXT, sw-addrmethod=CODE, symbol=CODE
        RTE_LIB_CODE: executable-entity=[Rte_GetCurrentTaskIndex, Rte_memcpy], prefix=RTE_LIB, sw-addrmethod=CODE, symbol=CODE
        RTE_MAIN_CODE: executable-entity=[Rte_MainFunction, Rte_Start, Rte_Stop, SchM_Deinit, SchM_Init], prefix=RTE_MAIN, sw-addrmethod=CODE, symbol=CODE
        RTE_MEMSWC_CODE: executable-entity=[Rte_Call_MemSWC_RP_NvM_ParkStatus_ReadBlock, Rte_Call_MemSWC_RP_NvM_ParkStatus_SetRamBlockStatus, Rte_Call_MemSWC_RP_NvM_ParkStatus_WriteBlock, Rte_Read_MemSWC_RP_ParkStatus_DE_ParkState], prefix=RTE_MEMSWC, sw-addrmethod=CODE, symbol=CODE
        RTE_OSTASK_ASW_PERIODICEVENTS_CODE: prefix=RTE_OSTASK_ASW_PERIODICEVENTS, sw-addrmethod=CODE, symbol=CODE
        RTE_OSTASK_ASW_SPORADICEVENTS_CODE: prefix=RTE_OSTASK_ASW_SPORADICEVENTS, sw-addrmethod=CODE, symbol=CODE
        RTE_OSTASK_BSW_CODE: prefix=RTE_OSTASK_BSW, sw-addrmethod=CODE, symbol=CODE
        RTE_PARKSWC_CODE: executable-entity=[Rte_Call_ParkSWC_RP_DioControl_DioActuate, Rte_Read_ParkSWC_RP_ParkControl_DE_ParkState, Rte_Write_ParkSWC_PP_ParkStatus_DE_ParkState], prefix=RTE_PARKSWC, sw-addrmethod=CODE, symbol=CODE
        RTE_SIG_S_PARKCONTROL_BOOL_CAN_NETWORK_CHANNEL_CAN_RX_CODE: executable-entity=Rte_COMCbk_S_ParkControl_bool_Can_Network_Channel_CAN_Rx, prefix=RTE_SIG_S_PARKCONTROL_BOOL_CAN_NETWORK_CHANNEL_CAN_RX, sw-addrmethod=CODE, symbol=CODE
        RTE_SYS_CODE: executable-entity=[Rte_DecrementWaitingCount, Rte_ReadQueue, Rte_WaitWithTimeout, SchM_IModeInit], prefix=RTE_SYS, sw-addrmethod=CODE, symbol=CODE
        RTE_SYSTEMSWC_CODE: executable-entity=[Rte_Call_SystemSWC_RP_KeyStatus_KeyStatus, Rte_Switch_SystemSWC_PP_ShutdownRequest_MDGP_MSI_ShutDown], prefix=RTE_SYSTEMSWC, sw-addrmethod=CODE, symbol=CODE
        CONST_UNSPECIFIED: alignment=UNSPECIFIED, sw-addrmethod=CONST
        VAR_CLEARED_16: alignment=16, sw-addrmethod=VAR_CLEARED
        RTE_SYS_VAR_CLEARED_32: alignment=32, prefix=RTE_SYS, sw-addrmethod=VAR_CLEARED, symbol=VAR_CLEARED_32
        RTE_AF_CPT_MEMSWC_DRE_RE_MEMSWC_STOREDATA_VAR_CLEARED_8: alignment=8, prefix=RTE_AF_CPT_MEMSWC_DRE_RE_MEMSWC_STOREDATA, sw-addrmethod=VAR_CLEARED, symbol=VAR_CLEARED_8
        RTE_AF_CPT_PARKSWC_DRE_RE_PARKSWC_MAIN_VAR_CLEARED_8: alignment=8, prefix=RTE_AF_CPT_PARKSWC_DRE_RE_PARKSWC_MAIN, sw-addrmethod=VAR_CLEARED, symbol=VAR_CLEARED_8
        RTE_OSTASK_ASW_PERIODICEVENTS_VAR_CLEARED_8: alignment=8, prefix=RTE_OSTASK_ASW_PERIODICEVENTS, sw-addrmethod=VAR_CLEARED, symbol=VAR_CLEARED_8
        RTE_OSTASK_BSW_VAR_CLEARED_8: alignment=8, prefix=RTE_OSTASK_BSW, sw-addrmethod=VAR_CLEARED, symbol=VAR_CLEARED_8
        VAR_CLEARED_BOOLEAN: alignment=BOOLEAN, sw-addrmethod=VAR_CLEARED
        VAR_INIT_8: alignment=8, sw-addrmethod=VAR_INIT
        VAR_INIT_UNSPECIFIED: alignment=UNSPECIFIED, sw-addrmethod=VAR_INIT
      15 x section name prefix:
        RTE_AF_CPT_MEMSWC_DRE_RE_MEMSWC_STOREDATA
        RTE_AF_CPT_PARKSWC_DRE_RE_PARKSWC_MAIN
        RTE_BSWM
        RTE_COMSWC
        RTE_EXT
        RTE_LIB
        RTE_MAIN
        RTE_MEMSWC
        RTE_OSTASK_ASW_PERIODICEVENTS
        RTE_OSTASK_ASW_SPORADICEVENTS
        RTE_OSTASK_BSW
        RTE_PARKSWC
        RTE_SIG_S_PARKCONTROL_BOOL_CAN_NETWORK_CHANNEL_CAN_RX
        RTE_SYS
        RTE_SYSTEMSWC
package /AUTOSAR_Rte/CompuMethods
  compu method AUTOSAR_Platform_CompuMethods_boolean: 0=FALSE, 1=TRUE
package /AUTOSAR_Rte/ImplementationDataTypes
  19 x impl type:
    Rte_REActCounterType: category=VALUE  # This is an external type, i.e. it is declared in the Rte Library and not in the XML. RTEGen does not have any information about this type apart from its name.
    Rte_PimType_MemSWC_parkStatus: category=TYPE_REFERENCE
    Rte_CDS_BswM: category=STRUCTURE
      element Rte_Dummy: implementation-data-type=uint8
    Rte_CDS_ComM: category=STRUCTURE
      element Rte_Dummy: implementation-data-type=uint8
    Rte_CDS_ComSWC: category=STRUCTURE
      element Rte_Dummy: implementation-data-type=uint8
    Rte_CDS_EcuM: category=STRUCTURE
      element Rte_Dummy: implementation-data-type=uint8
    Rte_CDS_MemSWC: category=STRUCTURE
      element Pim_ParkStatus: implementation-data-type=Rte_PimType_MemSWC_parkStatus
    Rte_CDS_NvM: category=STRUCTURE
      element Rte_Dummy: implementation-data-type=uint8
    Rte_CDS_ParkSWC: category=STRUCTURE
      element Rte_Dummy: implementation-data-type=uint8
    Rte_CDS_SystemSWC: category=STRUCTURE
      element Rte_Dummy: implementation-data-type=uint8
    Rte_SelfType_ComSWC: implementation-data-type=Rte_CDS_ComSWC
    Rte_SelfType_MemSWC: implementation-data-type=Rte_CDS_MemSWC
    Rte_SelfType_ParkSWC: implementation-data-type=Rte_CDS_ParkSWC
    Rte_SelfType_SystemSWC: implementation-data-type=Rte_CDS_SystemSWC
    Rte_SelfType_ComM: implementation-data-type=Rte_CDS_ComM
    Rte_SelfType_NvM: implementation-data-type=Rte_CDS_NvM
    Rte_SelfType_EcuM: implementation-data-type=Rte_CDS_EcuM
    Rte_SelfType_BswM: implementation-data-type=Rte_CDS_BswM
    Rte_TaskInfo: category=VALUE  # This is an external type, i.e. it is declared in the Rte Library and not in the XML. RTEGen does not have any information about this type apart from its name.
package /AUTOSAR_Rte/SwAddrMethods
  4 x sw addr method:
    CODE: memory-allocation-keyword-policy=ADDR-METHOD-SHORT-NAME, section-type=CODE
    CONST: memory-allocation-keyword-policy=ADDR-METHOD-SHORT-NAME-AND-ALIGNMENT, section-type=CONST
    VAR_CLEARED: memory-allocation-keyword-policy=ADDR-METHOD-SHORT-NAME-AND-ALIGNMENT, section-initialization-policy=CLEARED, section-type=VAR
    VAR_INIT: memory-allocation-keyword-policy=ADDR-METHOD-SHORT-NAME-AND-ALIGNMENT, section-initialization-policy=INIT, section-type=VAR
package /AUTOSAR_Rte/SwBaseTypes
  base type AUTOSAR_Platform_BaseTypes_uint8: category=FIXED_LENGTH, base-type-size=8, base-type-encoding=NONE, mem-alignment=8, native-declaration=uint8  # unsigned integer 8bit | This standard AUTOSAR type shall be of 8 bit unsigned.
  base type AUTOSAR_PlatformTypes_SwBaseTypes_uint8: category=FIXED_LENGTH, base-type-size=8, base-type-encoding=NONE, mem-alignment=8, native-declaration=uint8  # unsigned integer 8bit | This standard AUTOSAR type shall be of 8 bit unsigned.
  base type AUTOSAR_Platform_BaseTypes_boolean: category=FIXED_LENGTH, base-type-size=8, base-type-encoding=BOOLEAN, native-declaration=Boolean  # Boolean | The boolean type shall always be mapped to a platform specific type where pointers can be applied to enable a passing of parameters via API. There are specific BIT types of some HW platforms which are very efficient but where no pointers can point to. This standard AUTOSAR type shall only be used together with the definitions TRUE and FALSE. See PLATFORM027 for implementation and usage.
