VERSION ""

NS_ :

BS_:

BU_: ParkBrake EcuB

BO_ 171 ParkStatus: 1 ParkBrake
 SG_ ParkStatus_bool : 0|1@1+ (1,0) [0|1] ""  EcuB

BO_ 186 ParkControl: 1 EcuB
 SG_ ParkControl_bool : 0|1@1+ (1,0) [0|1] ""  ParkBrake

BA_DEF_  "BusType" STRING ;
BA_DEF_DEF_  "BusType" "CAN";
