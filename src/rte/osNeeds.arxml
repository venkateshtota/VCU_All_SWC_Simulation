AUTOSAR XML (schema 4-0-3)
package /OS
  module config Os
    RTE_RESOURCE (OsResource): OsResourceProperty=STANDARD
    3 x OsTask, all with OsTaskResourceRef=RTE_RESOURCE:
      OsTask_ASW_PeriodicEvents
      OsTask_ASW_SporadicEvents
      OsTask_BSW
    Rte_TickCounter (OsCounter): OsCounterMaxAllowedValue=65535, OsCounterMinCycle=1, OsCounterTicksPerBase=1, OsCounterType=SOFTWARE
    Rte_ScheduleTable (OsScheduleTable): OsScheduleTableRepeating=true, OsScheduleTableDuration=10, OsScheduleTableCounterRef=Rte_TickCounter
      10 x OsScheduleTableExpiryPoint:
        rte_Stimulus_1: OsScheduleTblExpPointOffset=0
          TaskActivation1 (OsScheduleTableTaskActivation): OsScheduleTableActivateTaskRef=OsTask_ASW_PeriodicEvents
          TaskActivation2 (OsScheduleTableTaskActivation): OsScheduleTableActivateTaskRef=OsTask_BSW
        rte_Stimulus_2: OsScheduleTblExpPointOffset=1
          TaskActivation1 (OsScheduleTableTaskActivation): OsScheduleTableActivateTaskRef=OsTask_BSW
        rte_Stimulus_3: OsScheduleTblExpPointOffset=2
          TaskActivation1 (OsScheduleTableTaskActivation): OsScheduleTableActivateTaskRef=OsTask_BSW
        rte_Stimulus_4: OsScheduleTblExpPointOffset=3
          TaskActivation1 (OsScheduleTableTaskActivation): OsScheduleTableActivateTaskRef=OsTask_BSW
        rte_Stimulus_5: OsScheduleTblExpPointOffset=4
          TaskActivation1 (OsScheduleTableTaskActivation): OsScheduleTableActivateTaskRef=OsTask_BSW
        rte_Stimulus_6: OsScheduleTblExpPointOffset=5
          TaskActivation1 (OsScheduleTableTaskActivation): OsScheduleTableActivateTaskRef=OsTask_BSW
        rte_Stimulus_7: OsScheduleTblExpPointOffset=6
          TaskActivation1 (OsScheduleTableTaskActivation): OsScheduleTableActivateTaskRef=OsTask_BSW
        rte_Stimulus_8: OsScheduleTblExpPointOffset=7
          TaskActivation1 (OsScheduleTableTaskActivation): OsScheduleTableActivateTaskRef=OsTask_BSW
        rte_Stimulus_9: OsScheduleTblExpPointOffset=8
          TaskActivation1 (OsScheduleTableTaskActivation): OsScheduleTableActivateTaskRef=OsTask_BSW
        rte_Stimulus_10: OsScheduleTblExpPointOffset=9
          TaskActivation1 (OsScheduleTableTaskActivation): OsScheduleTableActivateTaskRef=OsTask_BSW
