AUTOSAR XML (schema 4-2-2)
package /RTE
  module config Rte
    RteBswGeneral: RteSchMVersionInfoApi=0
    RteGeneration:
      RteBypassSupport = NONE
      RteCalibrationSupport = NONE
      RteDevErrorDetect = 0
      RteDevErrorDetectUninit = 0
      RteGenerationMode = COMPATIBILITY_MODE
      RteInExclusiveAreaCheckEnabled = 1
      RteMeasurementSupport = 0
      RteOptimizationMode = RUNTIME
      RteValueRangeCheckEnabled = 0
      RteVfbTraceAnonymousClientEnabled = 0
      RteVfbTraceEnabled = 0
    NoneSectionPolicies (RteInitializationBehavior): RteInitializationStrategy=RTE_INITIALIZATION_STRATEGY_NONE, RteSectionInitializationPolicy=NO-INIT
    RteOsInteraction
    DataDeclarationSectionPolicies (RteInitializationBehavior):
      RteInitializationStrategy = RTE_INITIALIZATION_STRATEGY_AT_DATA_DECLARATION
      RteSectionInitializationPolicy = INIT
      RteSectionInitializationPolicy = CLEARED
    RteStartSectionPolicies (RteInitializationBehavior):
      RteInitializationStrategy = RTE_INITIALIZATION_STRATEGY_AT_RTE_START_AND_PARTITION_RESTART
      RteSectionInitializationPolicy = POWER-ON-INIT
      RteSectionInitializationPolicy = POWER-ON-CLEARED
    4 x RteSwComponentInstance:
      CPT_ComSWC: RteSoftwareComponentInstanceRef=CPT_ComSWC
        TE_RE_ComSWC_main_10ms (RteEventToTaskMapping): RtePositionInTask=1, RteActivationOffset=0.0, RteMappedToTaskRef=OsTask_ASW_PeriodicEvents, RteEventRef=TE_RE_ComSWC_main_10ms
      CPT_SystemSWC: RteSoftwareComponentInstanceRef=CPT_SystemSWC
        TE_RE_SystemSWC_main_20ms (RteEventToTaskMapping): RtePositionInTask=2, RteActivationOffset=0.0, RteMappedToTaskRef=OsTask_ASW_PeriodicEvents, RteEventRef=TE_RE_SystemSWC_main_20ms
      CPT_ParkSWC: RteSoftwareComponentInstanceRef=CPT_ParkSWC
        DRE_RE_ParkSWC_main (RteEventToTaskMapping): RtePositionInTask=1, RteActivationOffset=0.0, RteMappedToTaskRef=OsTask_ASW_SporadicEvents, RteEventRef=DRE_RE_ParkSWC_main
      CPT_MemSWC: RteSoftwareComponentInstanceRef=CPT_MemSWC
        DRE_RE_MemSWC_StoreData (RteEventToTaskMapping): RtePositionInTask=2, RteActivationOffset=0.0, RteMappedToTaskRef=OsTask_ASW_SporadicEvents, RteEventRef=DRE_RE_MemSWC_StoreData
    7 x RteBswModuleInstance:
      CanSM: RteBswImplementationRef=CanSM
        EV_SE_MainFunction (RteBswEventToTaskMapping): RteBswPositionInTask=7, RteBswActivationOffset=0.0, RteBswMappedToTaskRef=OsTask_BSW, RteBswEventRef=EV_SE_MainFunction
      MemIf: RteBswImplementationRef=MemIf
        EV_MemIf_Rb_MainFunction (RteBswEventToTaskMapping): RteBswPositionInTask=8, RteBswActivationOffset=0.0, RteBswMappedToTaskRef=OsTask_BSW, RteBswEventRef=EV_MemIf_Rb_MainFunction
      Com: RteBswImplementationRef=Com
        EV_SE_MainFunctionRx (RteBswEventToTaskMapping): RteBswPositionInTask=10, RteBswActivationOffset=0.0, RteBswMappedToTaskRef=OsTask_BSW, RteBswEventRef=EV_SE_MainFunctionRx
        EV_SE_MainFunctionTx (RteBswEventToTaskMapping): RteBswPositionInTask=9, RteBswActivationOffset=0.0, RteBswMappedToTaskRef=OsTask_BSW, RteBswEventRef=EV_SE_MainFunctionTx
      ComM: RteBswImplementationRef=ComM
        EV_SE_MainFunction_Can_Network_Channel_Can_Network (RteBswEventToTaskMapping):
          RteBswPositionInTask = 11
          RteBswActivationOffset = 0.0
          RteBswMappedToTaskRef = OsTask_BSW
          RteBswEventRef = EV_SE_MainFunction_Can_Network_Channel_Can_Network
      NvM: RteBswImplementationRef=NvM
        EV_SE_MainFunction (RteBswEventToTaskMapping): RteBswPositionInTask=12, RteBswActivationOffset=0.0, RteBswMappedToTaskRef=OsTask_BSW, RteBswEventRef=EV_SE_MainFunction
      EcuM: RteBswImplementationRef=EcuM
        TE_EcuM_MainFunction (RteBswEventToTaskMapping): RteBswPositionInTask=6, RteBswActivationOffset=0.0, RteBswMappedToTaskRef=OsTask_BSW, RteBswEventRef=TE_EcuM_MainFunction
      BSWIMPL_BswM: RteBswImplementationRef=BSWIMPL_BswM
        6 x RteBswEventToTaskMapping:
          TE_BswM_MainFunction: RteBswPositionInTask=5, RteBswActivationOffset=0.0, RteBswMappedToTaskRef=OsTask_BSW, RteBswEventRef=TE_BswM_MainFunction
          MSE_BswM_Cfg_ImdtBswNotification_BswM_MRP_BswM_MDG_ECUM_STATE_APP_POST_RUN_0: RteBswEventRef=MSE_BswM_Cfg_ImdtBswNotification_BswM_MRP_BswM_MDG_ECUM_STATE_APP_POST_RUN
          MSE_BswM_Cfg_ImdtBswNotification_BswM_MRP_BswM_MDG_ECUM_STATE_STARTUP_ONE_0: RteBswEventRef=MSE_BswM_Cfg_ImdtBswNotification_BswM_MRP_BswM_MDG_ECUM_STATE_STARTUP_ONE
          MSE_BswM_Cfg_ImdtBswNotification_BswM_MRP_BswM_MDG_ECUM_STATE_STARTUP_TWO_0: RteBswEventRef=MSE_BswM_Cfg_ImdtBswNotification_BswM_MRP_BswM_MDG_ECUM_STATE_STARTUP_TWO
          MSE_BswM_Cfg_ImdtBswNotification_BswM_MRP_BswM_MDG_ECUM_STATE_APP_RUN_0: RteBswEventRef=MSE_BswM_Cfg_ImdtBswNotification_BswM_MRP_BswM_MDG_ECUM_STATE_APP_RUN
          MSE_BswM_Cfg_ImdtBswNotification_BswM_MRP_BswM_MDG_ECUM_STATE_RUN_0: RteBswEventRef=MSE_BswM_Cfg_ImdtBswNotification_BswM_MRP_BswM_MDG_ECUM_STATE_RUN
        RteBswRequiredModeGroupConnection:
          RteBswProvidedModeGroupRef = MDGP_AUTOSAR_BswM_ModeDeclarationGroups_MDG_ECUM_STATE
          RteBswProvidedModeGrpModInstRef = BSWIMPL_BswM
          RteBswRequiredModeGroupRef = MDGR_BswM_MRP_BswM_MDG
    CPT_BswM (RteSwComponentInstance): RteSoftwareComponentInstanceRef=CPT_BswM
      MSE_BswM_Cfg_DfrdSwcNotification_BswM_MRP_SwcModeRequest_SHUT_DOWN (RteEventToTaskMapping): RteEventRef=MSE_BswM_Cfg_DfrdSwcNotification_BswM_MRP_SwcModeRequest_SHUT_DOWN
    3 x RteBswModuleInstance:
      CanIf: RteBswImplementationRef=CanIf
      PduR: RteBswImplementationRef=PduR
      Can: RteBswImplementationRef=BSWIMPL_Can
        4 x RteBswEventToTaskMapping, all with RteBswActivationOffset=0.0, RteBswMappedToTaskRef=OsTask_BSW:
          BSWTE_MainFunction_Mode: RteBswPositionInTask=4, RteBswEventRef=BSWTE_MainFunction_Mode
          BSWTE_MainFunction_Read: RteBswPositionInTask=2, RteBswEventRef=BSWTE_MainFunction_Read
          BSWTE_MainFunction_BusOff: RteBswPositionInTask=1, RteBswEventRef=BSWTE_MainFunction_BusOff
          BSWTE_MainFunction_Write: RteBswPositionInTask=3, RteBswEventRef=BSWTE_MainFunction_Write
