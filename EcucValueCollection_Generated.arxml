AUTOSAR XML (schema 4-2-2)
package /ETAS_Project/EcucModuleConfigurationValuess
  ecuc value collection EcucValueCollection_0: ecu-extract=EXTR_ParkBrake, ecuc-values=[Rte, Os, ComStack, Com, CanIf, Can, PduR, CanSM, ComM, EcuC, NvM, Fee, rba_MemLib, MemIf, rba_ArxmlGen, EcuM, BswM, Bfx, Crc]
