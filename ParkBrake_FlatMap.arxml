AUTOSAR XML (schema 4-2-2)
package /ParkBrake_FlatView
  flat map ParkBrake_FlatMap
    5 x flat instance descriptor:
      CPT_ComSWC: upstream-reference=RootSwCompositionPrototype_0.CPT_ComSWC, ecu-extract-reference=CPT_ParkBrake_FlatView.CPT_ComSWC
      CPT_MemSWC: upstream-reference=RootSwCompositionPrototype_0.CPT_MemSWC, ecu-extract-reference=CPT_ParkBrake_FlatView.CPT_MemSWC
      CPT_ParkSWC: upstream-reference=RootSwCompositionPrototype_0.CPT_ParkSWC, ecu-extract-reference=CPT_ParkBrake_FlatView.CPT_ParkSWC
      CPT_SystemSWC: upstream-reference=RootSwCompositionPrototype_0.CPT_SystemSWC, ecu-extract-reference=CPT_ParkBrake_FlatView.CPT_SystemSWC
      DE_ParkState: sw-refresh-timing={cse-code=1000, cse-code-factor=1}, upstream-reference=RootSwCompositionPrototype_0.CPT_ParkSWC.PP_ParkStatus.DE_ParkState, ecu-extract-reference=CPT_ParkBrake_FlatView.CPT_ParkSWC.PP_ParkStatus.DE_ParkState
