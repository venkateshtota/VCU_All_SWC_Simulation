AUTOSAR XML (schema 4-2-2)
package /PortInterfaces
  sender receiver interface SR_IF_ParkState
    data DE_ParkState: type=ParkState
  client server interface CS_IF_DioControl
    operation DioActuate
      arg DioControl: type=ParkState, direction=IN, server-argument-impl-policy=USE-ARGUMENT-TYPE
  client server interface CS_IF_KeyStatus
    operation KeyStatus
      arg KeyStatus: type=KeyStatus, direction=OUT, server-argument-impl-policy=USE-ARGUMENT-TYPE
