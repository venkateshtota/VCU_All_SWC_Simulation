AUTOSAR XML (schema 4-2-2)
package /AUTOSAR_Rte/BswImplementations
  bsw implementation Rte: mc-support=mc-sw-emulation-method-support=category=NONE
package /AUTOSAR_Rte/Units
  8 x unit, all with factor-si-to-unit=1.0, offset-si-to-unit=0.0:
    AUTOSAR_CanIf_Units_NoUnit: display-name=noUnit, physical-dimension=AUTOSAR_CanIf_PhysicalDimensions_NoUnit  # No Unit
    AUTOSAR_ComM_Units_NoUnit: display-name=noUnit, physical-dimension=AUTOSAR_ComM_PhysicalDimensions_NoUnit  # No Unit
    AUTOSAR_NvM_Units_NoUnit: display-name=noUnit, physical-dimension=AUTOSAR_NvM_PhysicalDimensions_NoUnit  # No Unit
    RB_RBA_Common_CentralElements_Units_NoUnit: display-name=noUnit, physical-dimension=RB_RBA_Common_CentralElements_PhysicalDimensions_NoUnit  # No Unit
    AUTOSAR_Com_Units_NoUnit: display-name=noUnit, physical-dimension=AUTOSAR_Com_PhysicalDimensions_NoUnit  # No Unit
    RB_RBA_rba_MemLib_Units_Mem_NoUnit: display-name=Mem_NoUnit, physical-dimension=RB_RBA_rba_MemLib_PhysicalDimensions_Mem_NoPhysDim  # Mem No Unit / 1:1 / Identical
    AUTOSAR_PduR_Units_NoUnit: display-name=noUnit, physical-dimension=AUTOSAR_PduR_PhysicalDimensions_NoUnit  # No Unit
    AUTOSAR_CanSM_Units_NoUnit: display-name=noUnit, physical-dimension=AUTOSAR_CanSM_PhysicalDimensions_NoUnit  # No Unit
package /AUTOSAR_Rte/PhysicalDimensions
  8 x physical dimension, all with length-exp=0:
    AUTOSAR_CanIf_PhysicalDimensions_NoUnit
    AUTOSAR_ComM_PhysicalDimensions_NoUnit
    AUTOSAR_NvM_PhysicalDimensions_NoUnit
    RB_RBA_Common_CentralElements_PhysicalDimensions_NoUnit
    AUTOSAR_Com_PhysicalDimensions_NoUnit
    RB_RBA_rba_MemLib_PhysicalDimensions_Mem_NoPhysDim
    AUTOSAR_PduR_PhysicalDimensions_NoUnit
    AUTOSAR_CanSM_PhysicalDimensions_NoUnit
