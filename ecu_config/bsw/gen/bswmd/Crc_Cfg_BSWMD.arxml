AUTOSAR XML (schema 4-2-2)
package /AUTOSAR_Crc/BswImplementations
  bsw implementation Crc: programming-language=C, sw-version=7.1.0, ar-release-version=4.2.2, behavior=BswInternalBehavior, vendor-specific-module-def=Crc
    code-descriptors:
      code CodeDescriptor: artifact-descriptors=autosar-engineering-object={short-label=ArEngObj, category=SWSRC}
    resource consumption Crc_ResourceConsumption
      6 x memory section, all with prefix=CRC:
        CRC_CODE: sw-addrmethod=CODE, symbol=CODE
        CRC_CONST_64: sw-addrmethod=CONST, symbol=CONST_64
        CRC_CONST_32: sw-addrmethod=CONST, symbol=CONST_32
        CRC_CONST_16: sw-addrmethod=CONST, symbol=CONST_16
        CRC_CONST_8: sw-addrmethod=CONST, symbol=CONST_8
        TESTCD_CRC_CODE: sw-addrmethod=CODE, symbol=CODE
      section name prefix CRC
package /AUTOSAR_Crc/BswModuleDescriptions
  bsw module description Crc: category=BSW_MODULE, module-id=201
    provided-entrys:
      Crc_CalculateCRC8
      Crc_CalculateCRC8H2F
      Crc_CalculateCRC16
      Crc_CalculateCRC32
      Crc_CalculateCRC32P4
      Crc_CalculateCRC64
      Crc_GetVersionInfo
    bsw internal behavior BswInternalBehavior
      7 x bsw called entity:
        CalculateCRC8: implemented-entry=Crc_CalculateCRC8
        CalculateCRC8H2F: implemented-entry=Crc_CalculateCRC8H2F
        CalculateCRC16: implemented-entry=Crc_CalculateCRC16
        CalculateCRC32: implemented-entry=Crc_CalculateCRC32
        CalculateCRC32P4: implemented-entry=Crc_CalculateCRC32P4
        CalculateCRC64: implemented-entry=Crc_CalculateCRC64
        GetVersionInfo: implemented-entry=Crc_GetVersionInfo
package /AUTOSAR_Crc/BswModuleEntrys
  7 x bsw module entry, all with is-reentrant=true, is-synchronous=true, call-type=REGULAR, execution-context=UNSPECIFIED, sw-service-impl-policy=STANDARD:
    Crc_CalculateCRC8: service-id=1  # Crc_CalculateCRC8 provides the CRC8 routine based on the SAE-J1850 CRC8 Standard. The calculation method has to be configured in the configuration container CrcGeneral by defining the parameter Crc8Mode. Details can be found in the chapter about the configuration interface. | Example: The following code snippet gives two examples for the usage of the Crc_CalculateCRC8 routine. The first example deals with a non-interrupted calculation of the checksum, whereas the second example deals with an interrupted calculation of the checksum. Additionally, the usage of the public constant is given. /* -------------------------------------------------------------------------------------------------------*/ /* Initialize input data and expected result */ /* -------------------------------------------------------------------------------------------------------*/ uint8 input_u8[9] = {0x31, 0x32, 0x33, 0x34, 0x35, 0x36, 0x37, 0x38, 0x39}; uint8 res_u8; uint8 expected_res_u8 = 0x4B; /* -------------------------------------------------------------------------------------------------------*/ /* Calculate AUTOSAR CRC8 value in one step */ /* -------------------------------------------------------------------------------------------------------*/ /* without usage of the constant CRC_INITIAL_VALUE8 */ /* AR4.0 Rev 2 */ res_u8 = Crc_CalculateCRC8(&(input_u8[0]), 9, 0xFF, TRUE); /* Check the result */ if (res_u8 != expected_res_u8) { /* error handling */ } /* -------------------------------------------------------------------------------------------------------*/ /* Calculate AUTOSAR CRC8 value in three steps */ /* -------------------------------------------------------------------------------------------------------*/ /* AR4.0 Rev 2 */ /* First call, with 'initial value' and setting Crc_IsFirstCall to TRUE */ res_u8 = Crc_CalculateCRC8(&(input_u8[0]), 2, CRC_INITIAL_VALUE8, TRUE); /* for subsequent calls set Crc_IsFirstCall to FALSE and pass the result of the previous * call as start value. */ res_u8 = Crc_CalculateCRC8(&(input_u8[2]), 4, res_u8, FALSE); res_u8 = Crc_CalculateCRC8(&(input_u8[6]), 3, res_u8, FALSE); /* Check the result */ if (res_u8 != expected_res_u8) { /* error handling */ } Note, the check for function Crc_CalculateCRC8, result given in the AR4, Rev1 of the CRC Library is false. The failure is corrected in Rev2 and Rev3.
      return type ReturnValue: implementation-data-type=uint8  # 8 bit result of CRC calculation.
      4 x sw service arg, all with direction=IN:
        Crc_DataPtr: category=DATA_REFERENCE, sw-pointer-target-props={target-category=VALUE, implementation-data-type=uint8, sw-impl-policy=CONST}  # Pointer to the beginning of the input data stream.
        Crc_Length: category=VALUE, sw-pointer-target-props={target-category=VALUE, implementation-data-type=uint32}  # Length of the data stream.
        Crc_StartValue8: category=VALUE, implementation-data-type=uint8  # Start Value is either the initial value, given by constant CRC_INITIAL_VALUE8 or the result of the last CRC calculation. If AR4.0 Revision 1 is used, the former result must be XORed with the constant, given by CRC_XOR_VALUE8.
        Crc_IsFirstCall: category=BOOLEAN, implementation-data-type=boolean  # If it is set to TRUE, the start value is ignored and set to the standard start value. Otherwise the start value is used to continue calculating from this value. This means it is possible to divide the input into several parts and hand them in piecewise. To continue a calculation, the former result is committed as start-value and Crc_IsFirstCall is set to FALSE.
    Crc_CalculateCRC8H2F: service-id=5  # Crc_CalculateCRC8H2F provides a CRC8 routine based on the (truncated) generator polynomial 0x2F. The calculation method has to be configured in the configuration container CrcGeneral by defining the parameter Crc8H2FMode. Details can be found in the chapter about the configuration interface. | Example: The following code snippet gives two examples for the usage of the Crc_CalculateCRC8 routine. The first example deals with a non-interrupted calculation of the checksum, whereas the second example deals with an interrupted calculation of the checksum. Additionally, the usage of the public constant is given. /* -------------------------------------------------------------------------------------------------------*/ /* Initialize input data and expected result */ /* -------------------------------------------------------------------------------------------------------*/ uint8 input_u8[9] = {0x31, 0x32, 0x33, 0x34, 0x35, 0x36, 0x37, 0x38, 0x39}; uint8 res_u8; uint8 expected_res_u8 = 0x4B; /* -------------------------------------------------------------------------------------------------------*/ /* Calculate AUTOSAR CRC8 value in one step */ /* -------------------------------------------------------------------------------------------------------*/ /* without usage of the constant CRC_INITIAL_VALUE8 */ /* AR4.0 Rev 2 */ res_u8 = Crc_CalculateCRC8H2F(&(input_u8[0]), 9, 0xFF, TRUE); /* Check the result */ if (res_u8 != expected_res_u8) { /* error handling */ } /* -------------------------------------------------------------------------------------------------------*/ /* Calculate AUTOSAR CRC8 value in three steps */ /* -------------------------------------------------------------------------------------------------------*/ /* AR4.0 Rev 2 */ /* First step, with setting Crc_IsFirstCall to TRUE */ res_u8 = Crc_CalculateCRC8H2F(&(input_u8[0]), 2, CRC_INITIAL_VALUE8, TRUE); /* Second step, with setting Crc_IsFirstCall to FALSE */ res_u8 = Crc_CalculateCRC8H2F(&(input_u8[2]), 4, res_u8, FALSE); /* Third step, with setting Crc_IsFirstCall to FALSE */ res_u8 = Crc_CalculateCRC8H2F(&(input_u8[6]), 3, res_u8, FALSE); /* Check the result */ if (res_u8 != expected_res_u8) { /* error handling */ } Note, the check for function CalculateCRC8H2F, given in the AR4, Rev1 of the CRC Library, has a false result value in the specification. The failure of the specification is corrected in Rev2 and Rev3.
      return type ReturnValue: implementation-data-type=uint8  # 8 bit result of CRC calculation.
      4 x sw service arg, all with direction=IN:
        Crc_DataPtr: category=DATA_REFERENCE, sw-pointer-target-props={target-category=VALUE, implementation-data-type=uint8, sw-impl-policy=CONST}  # Pointer to the beginning of the input data stream.
        Crc_Length: category=VALUE, implementation-data-type=uint32  # Length of the data stream.
        Crc_StartValue8: category=VALUE, implementation-data-type=uint8  # Start value, is either the initial value, given by constant CRC_INITIAL_VALUE8H2F or CRC_INITIAL_VALUE8 or the result of the last CRC calculation.If AR4.0 Revision 1 is used, the former result must be XORed with the constant, given by CRC_XOR_VALUE8H2F or CRC_XOR_VALUE8.
        Crc_IsFirstCall: category=BOOLEAN, implementation-data-type=boolean  # If it is set to TRUE, the start value is ignored and set to the standard start value. Otherwise the start value is used to continue calculating from this value. This means it is possible to divide the input into several parts and hand them in piecewise. To continue a calculation, the former result is committed as start-value and Crc_IsFirstCall is set to FALSE.
    Crc_CalculateCRC16: service-id=2  # Crc_CalculateCRC16 provides the CRC16 routine based on the CCITT-FALSE CRC16 Standard. The calculation method has to be configured in the configuration container CrcGeneral by defining the parameter Crc16Mode. Details can be found in the chapter about the configuration interface. | Restrictions: The implementation is based on the assumption of a big byte endianness. In case of a big byte endianness, the pointer to an input data stream "Crc_DataPtr" is also realizable as a cast pointer to an uint16 data stream. In case of little byte endianness the usage of a cast pointer will lead to a wrong result as the byte sequence is not correct. Example: The following code snippet gives four examples for the usage of the Crc_CalculateCRC16 routine. The first example deals with a non-interrupted calculation of the checksum, whereas the second example deals with an interrupted calculation of the checksum. Additionally, the usage of the public constant is given. The third examples deals with an uint16 input vector under the assumption of big byte endianness, whereas the forth examples assumes little byte endianness. For all examples, the expected result is identical. Note, the difference in the input values BB_input_u16 and LB_input_u16, the correct input LB or BB has to be selected with respect to the byte endianness of the target controller. /* -------------------------------------------------------------------------------------------------------*/ /* Initialize input data and expected result */ /* -------------------------------------------------------------------------------------------------------*/ uint8 input_u8[9] = {0x31, 0x32, 0x33, 0x34, 0x35, 0x36, 0x37, 0x38, 0x39}; uint16 BB_input_u16 = {0x3231, 0x3433, 0x3635, 0x3837, 0x0039}; uint16 LB_input_u16 = {0x3132, 0x3334, 0x3536, 0x3738, 0x3900}; uint16 res_u16; uint16 expected_res_u16 = 0x29B1; /* -------------------------------------------------------------------------------------------------------*/ /* Calculate AUTOSAR CRC16 value in one step */ /* -------------------------------------------------------------------------------------------------------*/ /* without usage of the constant CRC_INITIAL_VALUE16 */ /* AR4.0 Rev 2 */ res_u16 = Crc_CalculateCRC16(&(input_u8[0]), 9, 0xFFFF, TRUE); /* Check the result */ if (res_u16 != expected_res_u16) { /* error handling */ } /* -------------------------------------------------------------------------------------------------------*/ /* Calculate AUTOSAR CRC16 value in three steps */ /* -------------------------------------------------------------------------------------------------------*/ /* AR4.0 Rev 2 */ /* First step, with setting Crc_IsFirstCall to TRUE */ res_u16 = Crc_CalculateCRC16(&(input_u8[0]), 1, CRC_INITIAL_VALUE16, TRUE); /* Second step, with setting Crc_IsFirstCall to FASLE */ res_u16 = Crc_CalculateCRC16(&(input_u8[1]), 5, res_u16, FALSE); /* Third step, without setting Crc_IsFirstCall to FALSE */ res_u16 = Crc_CalculateCRC16(&(input_u8[6]), 3, res_u16, FALSE); /* Check the result */ if (res_u8 != expected_res_u8) { /* error handling */ } /* ------------------------------------------------------------------------------------------------------- * Calculate AUTOSAR CRC16 value in one step: big byte endianness * Note, the expected result is only correctly calculated if the target works with big byte endianness * -------------------------------------------------------------------------------------------------------*/ /* AR4.0 Rev 2 */ /* without usage of the constant CRC_INITIAL_VALUE16 */ res_u16 = Crc_CalculateCRC16((uint8*)(&(BB_input_u16[0])), 9, 0xFFFF, TRUE); /* Check the result */ if (res_u16 != expected_res_u16) { /* error handling */ } /* ------------------------------------------------------------------------------------------------------- * Calculate AUTOSAR CRC16 value in one step: little byte endianness * Note, the expected result is only correctly calculated if the target works with little byte endianness * -------------------------------------------------------------------------------------------------------*/ /* AR4.0 Rev 2 */ /* without usage of the constant CRC_INITIAL_VALUE16 */ res_u16 = Crc_CalculateCRC16((uint8*)(&(LB_input_u16[0])), 9, 0xFFFF, TRUE); /* Check the result */ if (res_u16 != expected_res_u16) { /* error handling */ } Note, in the example Calculate AUTOSAR CRC16 value in three steps, in the third step, there is no XOR operation as the CRC_XOR_VALUE16 is 0x0000 and does not have any impact.
      return type ReturnValue: implementation-data-type=uint16  # 16 bit result of CRC calculation.
      4 x sw service arg, all with direction=IN:
        Crc_DataPtr: category=DATA_REFERENCE, sw-pointer-target-props={target-category=VALUE, implementation-data-type=uint8, sw-impl-policy=CONST}  # Pointer to the beginning of the input data stream.
        Crc_Length: category=VALUE, implementation-data-type=uint32  # Length of the data stream.
        Crc_StartValue16: category=VALUE, implementation-data-type=uint16  # Start value, is either the initial value, given by constant CRC_INITIAL_VALUE16 or the result of the last CRC calculation. If AR4.0 Revision 1 is used, the former result must be XORed with the constant, given by CRC_XOR_VALUE16. Hint: In case the calculation is the continuation the XOR operation of the previous result is not required. Rationale, the CRC_XOR_VALUE16 is 0x0000, which does not have any impact in a XOR operation.
        Crc_IsFirstCall: category=BOOLEAN, implementation-data-type=boolean  # If it is set to TRUE, the start value is ignored and set to the standard start value. Otherwise the start value is used to continue calculating from this value. This means it is possible to divide the input into several parts and hand them in piecewise. To continue a calculation, the former result is committed as start-value and Crc_IsFirstCall is set to FALSE.
    Crc_CalculateCRC32: service-id=3  # Crc_CalculateCRC32 provides the CRC32 routine based on the IEEE-802.3 CRC32 Ethernet Standard. The calculation method has to be configured in the configuration container CrcGeneral by defining the parameter Crc32Mode. Details can be found in the chapter about the configuration interface. | Restrictions: The implementation is based on the assumption of a big byte endianness. In case of a big byte endianness, the pointer to an input data stream "Crc_DataPtr" is also realizable as a cast pointer to an uint32 data stream. In case of little byte endianness the usage of a cast pointer will lead to a wrong result as the byte sequence is not correct. Example: The following code snippet gives four examples for the usage of the Crc_CalculateCRC32 routine. The first example deals with a non-interrupted calculation of the checksum, whereas the second example deals with an interrupted calculation of the checksum. Additionally the usage of the public constant is given. The third example deals with an uint16 input vector under the assumption of big byte endianness, whereas the forth examples assumes little byte endianness. For all examples, the expected result is identical. Note, the difference in the input values BB_input_u32 and LB_input_u32, the correct input LB or BB has to be selected with respect to the byte endianness of the target controller. /* -------------------------------------------------------------------------------------------------------*/ /* Initialize input data and expected result */ /* -------------------------------------------------------------------------------------------------------*/ uint8 input_u8[9] = {0x31, 0x32, 0x33, 0x34, 0x35, 0x36, 0x37, 0x38, 0x39}; uint32 BB_input_u32 = {0x34333231, 0x38373635, 0x00000039}; uint32 LB_input_u32 = {0x31323334, 0x35363738, 0x39000000}; uint32 res_u32; uint32 expected_res_u32 = 0xCBF43926; /* ------------------------------------------------------------------------------------------------------- * Calculate AUTOSAR CRC32 value in one step * -------------------------------------------------------------------------------------------------------*/ /* without usage of the constant CRC_INITIAL_VALUE32 */ /* AR4.0 Rev 2 */ res_u32 = Crc_CalculateCRC32(&(input_u8[0]), 9, 0xFFFFFFFF, TRUE); /* Check the result */ if (res_u32 != expected_res_u32) { /* error handling */ } /* -------------------------------------------------------------------------------------------------------*/ /* Calculate AUTOSAR CRC32 value in three steps */ /* -------------------------------------------------------------------------------------------------------*/ /* AR4.0 Rev 2 */ /* First step, with setting Crc_IsFirstCall to TRUE */ res_u32 = Crc_CalculateCRC32(&(input_u8[0]), 3, CRC_INITIAL_VALUE32, TRUE); /* Second step, with setting Crc_IsFirstCall to FALSE */ res_u32 = Crc_CalculateCRC32(&(input_u8[3]), 3, res_u32, FALSE); /* Third step, with setting Crc_IsFirstCall to FALSE */ res_u32 = Crc_CalculateCRC32(&(input_u8[6]), 3, res_u32, FALSE); /* Check the result */ if (res_u32 != expected_res_u32) { /* error handling */ } /* ------------------------------------------------------------------------------------------------------- * Calculate AUTOSAR CRC32 value in one step: big byte endianness * Note, the expected result is only correct calculated if the target works with big byte endianness * -------------------------------------------------------------------------------------------------------*/ /* AR4.0 Rev 2 */ /* without usage of the constant CRC_INITIAL_VALUE32 */ res_u32 = Crc_CalculateCRC32((uint8*) (&(BB_input_u32[0])), 9, 0xFFFFFFFF, TRUE); /* Check the result */ if (res_u32 != expected_res_u32) { /* error handling */ } /* ------------------------------------------------------------------------------------------------------- * Calculate AUTOSAR CRC32 value in one step: little byte endianness * Note, the expected result is only correct calculated if the target works with little byte endianness * -------------------------------------------------------------------------------------------------------*/ /* AR4.0 Rev 2 */ /* without usage of the constant CRC_INITIAL_VALUE32 */ res_u32 = Crc_CalculateCRC32((uint8*) (&(LB_input_u32[0])), 9, 0xFFFFFFFF, TRUE); /* Check the result */ if (res_u16 != expected_res_u16) { /* error handling */ }
      return type ReturnValue: implementation-data-type=uint32  # 32 bit result of CRC calculation.
      4 x sw service arg, all with direction=IN:
        Crc_DataPtr: category=DATA_REFERENCE, sw-pointer-target-props={target-category=VALUE, implementation-data-type=uint8, sw-impl-policy=CONST}  # Pointer to the beginning of the input data stream.
        Crc_Length: implementation-data-type=uint32  # Length of the data stream.
        Crc_StartValue32: category=VALUE, implementation-data-type=uint32  # Start Value, is either the initial value, given by constant CRC_INITIAL_VALUE32 or the result of the last CRC calculation. If AR4.0 Revision 1 is used, the former result must be back-manipulated. It has to be reflected and XORed with the constant, given by CRC_XOR_VALUE32 (see AUTOSAR specification of CRC Library 4.0 Rev 1)
        Crc_IsFirstCall: category=BOOLEAN, implementation-data-type=boolean  # If it is set to TRUE, the start value is ignored and set to the standard start value. Otherwise the start value is used to continue calculating from this value. This means it is possible to divide the input into several parts and hand them in piecewise. To continue a calculation, the former result is committed as start-value and Crc_IsFirstCall is set to FALSE.
    Crc_CalculateCRC32P4: service-id=8  # Crc_CalculateCRC32P4 provides the CRC32 routine for E2E Profile 4 (32-bit 0xF4ACFB13 polynomial CRC calculation). The calculation method has to be configured in the configuration container CrcGeneral by defining the parameter Crc32P4Mode. Details can be found in the chapter about the configuration interface. | Restrictions: The implementation is based on the assumption of a big byte endianness. In case of a big byte endianness, the pointer to an input data stream "Crc_DataPtr" is also realizable as a cast pointer to an uint32 data stream. In case of little byte endianness the usage of a cast pointer will lead to a wrong result as the byte sequence is not correct. Example: The following code snippet gives four examples for the usage of the Crc_CalculateCRC32P4 routine. The first example deals with a non-interrupted calculation of the checksum, whereas the second example deals with an interrupted calculation of the checksum. Additionally the usage of the public constant is given. The third example deals with an uint16 input vector under the assumption of big byte endianness, whereas the forth examples assumes little byte endianness. For all examples, the expected result is identical. Note, the difference in the input values BB_input_u32 and LB_input_u32, the correct input LB or BB has to be selected with respect to the byte endianness of the target controller. /* -------------------------------------------------------------------------------------------------------*/ /* Initialize input data and expected result */ /* -------------------------------------------------------------------------------------------------------*/ uint8 input_u8[9] = {0x31, 0x32, 0x33, 0x34, 0x35, 0x36, 0x37, 0x38, 0x39}; uint32 BB_input_u32 = {0x34333231, 0x38373635, 0x00000039}; uint32 LB_input_u32 = {0x31323334, 0x35363738, 0x39000000}; uint32 res_u32; uint32 expected_res_u32 = 0x1697D06A; /* ------------------------------------------------------------------------------------------------------- * Calculate AUTOSAR CRC32P4 value in one step * -------------------------------------------------------------------------------------------------------*/ /* without usage of the constant CRC_INITIAL_VALUE32 */ /* AR4.0 Rev 2 */ res_u32 = Crc_CalculateCRC32P4(&(input_u8[0]), 9, 0xFFFFFFFF, TRUE); /* Check the result */ if (res_u32 != expected_res_u32) { /* error handling */ } /* -------------------------------------------------------------------------------------------------------*/ /* Calculate AUTOSAR CRC32P4 value in three steps */ /* -------------------------------------------------------------------------------------------------------*/ /* AR4.0 Rev 2 */ /* First step, with setting Crc_IsFirstCall to TRUE */ res_u32 = Crc_CalculateCRC32P4(&(input_u8[0]), 3, CRC_INITIAL_VALUE32, TRUE); /* Second step, with setting Crc_IsFirstCall to FALSE */ res_u32 = Crc_CalculateCRC32P4(&(input_u8[3]), 3, res_u32, FALSE); /* Third step, with setting Crc_IsFirstCall to FALSE */ res_u32 = Crc_CalculateCRC32P4(&(input_u8[6]), 3, res_u32, FALSE); /* Check the result */ if (res_u32 != expected_res_u32) { /* error handling */ } /* ------------------------------------------------------------------------------------------------------- * Calculate AUTOSAR CRC32P4 value in one step: big byte endianness * Note, the expected result is only correct calculated if the target works with big byte endianness * -------------------------------------------------------------------------------------------------------*/ /* AR4.0 Rev 2 */ /* without usage of the constant CRC_INITIAL_VALUE32 */ res_u32 = Crc_CalculateCRC32P4((uint8*) (&(BB_input_u32[0])), 9, 0xFFFFFFFF, TRUE); /* Check the result */ if (res_u32 != expected_res_u32) { /* error handling */ } /* ------------------------------------------------------------------------------------------------------- * Calculate AUTOSAR CRC32P4 value in one step: little byte endianness * Note, the expected result is only correct calculated if the target works with little byte endianness * -------------------------------------------------------------------------------------------------------*/ /* AR4.0 Rev 2 */ /* without usage of the constant CRC_INITIAL_VALUE32 */ res_u32 = Crc_CalculateCRC32P4((uint8*) (&(LB_input_u32[0])), 9, 0xFFFFFFFF, TRUE); /* Check the result */ if (res_u16 != expected_res_u16) { /* error handling */ }
      return type ReturnValue: implementation-data-type=uint32  # 32 bit result of CRC calculation for E2E Profile 4.
      4 x sw service arg, all with direction=IN:
        Crc_DataPtr: category=DATA_REFERENCE, sw-pointer-target-props={target-category=VALUE, implementation-data-type=uint8, sw-impl-policy=CONST}  # Pointer to the beginning of the input data stream.
        Crc_Length: implementation-data-type=uint32  # Length of the data stream.
        Crc_StartValue32: category=VALUE, implementation-data-type=uint32  # Start Value, is either the initial value, given by constant CRC_INITIAL_VALUE32 or the result of the last CRC calculation. If AR4.0 Revision 1 is used, the former result must be back-manipulated. It has to be reflected and XORed with the constant, given by CRC_XOR_VALUE32 (see AUTOSAR specification of CRC Library 4.0 Rev 1)
        Crc_IsFirstCall: category=BOOLEAN, implementation-data-type=boolean  # If it is set to TRUE, the start value is ignored and set to the standard start value. Otherwise the start value is used to continue calculating from this value. This means it is possible to divide the input into several parts and hand them in piecewise. To continue a calculation, the former result is committed as start-value and Crc_IsFirstCall is set to FALSE.
    Crc_CalculateCRC64: service-id=7  # Crc_CalculateCRC64 provides the CRC64 routine based on the ECMA 182 Standard. The calculation method has to be configured in the configuration container CrcGeneral by defining the parameter Crc64Mode. Details can be found in the chapter about the configuration interface. | Restrictions: The implementation makes no assumptions regarding endianness of the target system. On big endian targets, an uint16 or uint32 pointer can be cast to an uint8 pointer and the resulting crc will be correct. On little endian systems a pointer to data other than uint8 will lead to the wrong result, because of the different byte order. Example: The following code snippet gives four examples for the usage of the Crc_CalculateCRC64 routine. The first example deals with a non-interrupted calculation of the checksum, whereas the second example deals with an interrupted calculation of the checksum. Additionally the usage of the public constant is given. The third example deals with an uint16 input vector under the assumption of big endian byte order, whereas the forth example assumes little endian byte order. For all examples, the expected result is identical. Note, the difference in the input values BE_input_u32 and LE_input_u32, the correct input LE or BE has to be selected with respect to the endianness of the target controller. /* -------------------------------------------------------------------------------------------------------*/ /* Initialize input data and expected result */ /* -------------------------------------------------------------------------------------------------------*/ uint8 input_u8[9] = {0x31, 0x32, 0x33, 0x34, 0x35, 0x36, 0x37, 0x38, 0x39}; uint32 BE_input_u32 = {0x34333231, 0x38373635, 0x00000039}; uint32 LE_input_u32 = {0x31323334, 0x35363738, 0x39000000}; uint64 res_u64; uint64 expected_res_u64 = 0x995DC9BBDF1939FA; /* ------------------------------------------------------------------------------------------------------- * Calculate AUTOSAR CRC64 value in one step * -------------------------------------------------------------------------------------------------------*/ /* without usage of the constant CRC_INITIAL_VALUE64 */ res_u64 = Crc_CalculateCRC64(input_u8, 9, 0xFFFFFFFFFFFFFFFF, TRUE); /* Check the result */ if (res_u64 != expected_res_u64) { /* error handling */ } /* -------------------------------------------------------------------------------------------------------*/ /* Calculate AUTOSAR CRC64 value in three steps */ /* -------------------------------------------------------------------------------------------------------*/ /* First step, with setting Crc_IsFirstCall to TRUE */ res_u64 = Crc_CalculateCRC64(&(input_u8[0]), 3, CRC_INITIAL_VALUE64, TRUE); /* Second step, with setting Crc_IsFirstCall to FALSE */ res_u64 = Crc_CalculateCRC64(&(input_u8[3]), 3, res_u64, FALSE); /* Third step, with setting Crc_IsFirstCall to FALSE */ res_u64 = Crc_CalculateCRC64(&(input_u8[6]), 3, res_u64, FALSE); /* Check the result */ if (res_u64 != expected_res_u64) { /* error handling */ } /* ------------------------------------------------------------------------------------------------------- * Calculate AUTOSAR CRC64 value in one step: big endian * Note: the calculated checksum only matches the expected result if the target system is big endian. * -------------------------------------------------------------------------------------------------------*/ /* without usage of the constant CRC_INITIAL_VALUE64 */ res_u64 = Crc_CalculateCRC64((uint8*) (&(BE_input_u32[0])), 9, 0xFFFFFFFFFFFFFFFF, TRUE); /* Check the result */ if (res_u64 != expected_res_u64) { /* error handling */ } /* ------------------------------------------------------------------------------------------------------- * Calculate AUTOSAR CRC64 value in one step: little endian * Note: the calculated checksum only matches the expected result if the target system is little endian. * -------------------------------------------------------------------------------------------------------*/ /* without usage of the constant CRC_INITIAL_VALUE64 */ res_u64 = Crc_CalculateCRC64((uint8*) (&(LE_input_u32[0])), 9, 0xFFFFFFFFFFFFFFFF, TRUE); /* Check the result */ if (res_u64 != expected_res_u64) { /* error handling */ }
      return type ReturnValue: implementation-data-type=uint64  # 64 bit result of CRC calculation.
      4 x sw service arg, all with direction=IN:
        Crc_DataPtr: category=DATA_REFERENCE, sw-pointer-target-props={target-category=VALUE, implementation-data-type=uint8, sw-impl-policy=CONST}  # Pointer to the beginning of the input data stream.
        Crc_Length: implementation-data-type=uint32  # Length of the data stream.
        Crc_StartValue64: category=VALUE, implementation-data-type=uint64  # Start Value, is either the initial value, given by constant CRC_INITIAL_VALUE64 or the result of the last CRC calculation.
        Crc_IsFirstCall: category=BOOLEAN, implementation-data-type=boolean  # If it is set to TRUE, the value in Crc_StartValue64 is ignored and the default value of CRC_INITIAL_VALUE64 is used. Otherwise the value in Crc_StartValue64 is used to continue the CRC calculation. This means it is possible to split the input into several parts and process them piece by piece. To continue a calculation, the previous result is passed on as Crc_StartValue64 and Crc_IsFirstCall is set to FALSE.
    Crc_GetVersionInfo: service-id=4  # Provides a function for reading the version information of the CRC module. This information could be used to check the compatibility of the integrated software modules. | The function Crc_GetVersionInfo shall store the version information of this module into the parameter VersionInfo. The version information includes: | vendor ID module ID instance ID sw_major_version sw_minor_version sw_patch_version Example: The following code snippet gives an example for the usage of the Crc_GetVersionInfo routine. In the example, the terms VENDOR_ID, MODULE_ID, SW_MAJOR_VERSION, SW_MINOR_VERSION and SW_PATCH_VERSION are place holders for user defined values. Std_VersionInfoType Crc_Std_VersionInfo; Crc_GetVersionInfo(&Crc_Std_VersionInfo); /* Check the result */ if ((CRC_Std_Version.vendorID != VENDOR_ID) || (CRC_Std_Version.moduleID != MODULE_ID) || (CRC_Std_Version.sw_major_!= SW_MAJOR_VERSION) || (CRC_Std_Version.sw_minor_!= SW_MINOR_VERSION) || (CRC_Std_Version.sw_patch_version != SW_PATCH_VERSION)) { /* error handling */ }
      sw service arg VersionInfo: category=DATA_REFERENCE, direction=OUT, sw-pointer-target-props={target-category=VALUE, implementation-data-type=Std_VersionInfoType}  # Pointer to where to store the version information of this module.
package /AUTOSAR_Crc/ImplementationDataTypes
  impl type Crc_DataType: category=UNION, type-emitter=HEADER_FILE  # data type passed to hw calculation function, based on whether the data is 8bit or 16bit the following are used.
    element b8Ptr: implementation-data-type=uint8, additional-native-type-qualifier=constant
    element b16Ptr: implementation-data-type=uint16, additional-native-type-qualifier=constant
    element res: category=ARRAY
      element res: array-size=6, array-size-semantics=FIXED-SIZE, implementation-data-type=uint32
