AUTOSAR XML (schema 4-2-2)
package /DBC_SysDesc_Can_Network/Pkg_Cluster
  can cluster Can_Network: protocol-name=CAN
    can physical channel Can_Network_Channel: comm-connectors=Conn_Can_Network_CANNODE_0_ParkBrake
      frame ParkControl: id 0xBA, to ParkBrake, frame-length=1, can-addressing-mode=STANDARD, can-frame-rx-behavior=ANY
        pdu ParkControl: length=1, transmission-mode-condition{data-filter={data-filter-type=ALWAYS, max=1, min=0, offset=0}, i-signal-in-i-pdu=ParkControl_bool}, transmission-mode-false-timing=cyclic-timing=time-period=0.1, transmission-mode-true-timing=cyclic-timing=time-period=0.1
          signal ParkControl_bool: start 0, 1 bit, little-endian, base-type=uint8, compu {raw=phys for phys 0..1}, to ParkBrake
      frame ParkStatus: id 0xAB, from ParkBrake, frame-length=1, can-addressing-mode=STANDARD
        pdu ParkStatus: length=1, transmission-mode-condition{data-filter={data-filter-type=ALWAYS, max=1, min=0, offset=0}, i-signal-in-i-pdu=ParkStatus_bool}, transmission-mode-false-timing=cyclic-timing=time-period=0.1, transmission-mode-true-timing=cyclic-timing=time-period=0.1
          signal ParkStatus_bool: start 0, 1 bit, little-endian, base-type=uint8, compu {raw=phys for phys 0..1}
package /DBC_SysDesc_Can_Network/Pkg_Ecu
  ecu instance ParkBrake: com-configuration-gw-time-base=0.005, com-configuration-rx-time-base=0.01, com-configuration-tx-time-base=0.01, sleep-mode-supported=false, wake-up-over-bus-supported=false
    can communication controller Can_Network_CANNODE_0: can-controller-attributes=can-controller-configuration={prop-seg=0, sync-jump-width=0, time-seg-1=10, time-seg-2=0}
    can communication connector Conn_Can_Network_CANNODE_0_ParkBrake: comm-controller=Can_Network_CANNODE_0
package /System
  system ParkBrakeSystem: category=SYSTEM_DESCRIPTION
    system mapping SystemMapping
      data-mappings:
        data-element=CPT_ComSWC.RootSwCompositionPrototype_0.PP_comParkStatus.DE_ParkState, system-signal=ParkStatus_bool
        data-element=CPT_ComSWC.RootSwCompositionPrototype_0.RP_comParkControl.DE_ParkState, system-signal=ParkControl_bool
      sw-mappings:
        swc to ecu mapping SwcToEcuMapping_0: ecu-instance=ParkBrake
          component:
            RootSwCompositionPrototype_0.CPT_ComSWC
            RootSwCompositionPrototype_0.CPT_MemSWC
            RootSwCompositionPrototype_0.CPT_ParkSWC
            RootSwCompositionPrototype_0.CPT_SystemSWC
    root-software-compositions:
      root sw composition prototype RootSwCompositionPrototype_0: software-composition=TopLevelComposition
