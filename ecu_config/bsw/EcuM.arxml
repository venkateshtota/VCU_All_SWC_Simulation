AUTOSAR XML (schema 4-2-2)
package /EcuM
  module config EcuM
    EcuMConfiguration_0 (EcuMConfiguration)
      EcuMCommonConfiguration_0 (EcuMCommonConfiguration): EcuMDefaultAppMode=OSDEFAULTAPPMODE
        EcuMDefaultShutdownTarget_0 (EcuMDefaultShutdownTarget): EcuMDefaultState=EcuMStateOff
        EcuMWakeupSource_0 (EcuMWakeupSource): EcuMCheckWakeupTimeout=0.0
        EcuMDriverInitListOne
          Mcu_Init (EcuMDriverInitItem): EcuMModuleID=Mcu, EcuMModuleParameter=POSTBUILD_PTR, EcuMModuleService=Init
      EcuMFlexConfiguration_0 (EcuMFlexConfiguration)
        EcuMFlexUserConfig_0 (EcuMFlexUserConfig): EcuMFlexUser=0
        EcuMResetMode_0 (EcuMResetMode)
        EcuMShutdownCause_0 (EcuMShutdownCause)
        EcuMGoDownAllowedUsers: EcuMGoDownAllowedUserRef=EcuMFlexUserConfig_0
    EcuMGeneral_0 (EcuMGeneral):
      EcuMDevErrorDetect = 0
      EcuMRbConfigCCASInit = 0
      EcuMRbDisableNvM = 0
      EcuMRbIncludeComm = 1
      EcuMRbModeSwitchQueueLength = 1
      EcuMRbSlaveCoreEarlierStart = 0
      EcuMRbStartupDuration = 0
      EcuMRbUserTypeUpdate = 0
      EcuMVersionInfoApi = 0
      EcuMIncludeDet = false
      EcuMMainFunctionPeriod = 0.01
      EcuMRbIncludeHeaderList: EcuMRbModuleHeader=Mcu_Cbk
