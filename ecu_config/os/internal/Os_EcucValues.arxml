AUTOSAR XML (schema 4-2-2)
package /OS
  module config Os
    OSDEFAULTAPPMODE (OsAppMode)
    OsOS: OsStackMonitoring=false, OsUseGetServiceId=true, OsUseParameterAccess=true, OsUseResScheduler=true, OsStatus=STANDARD, OsScalabilityClass=SC1
      OsHooks: OsErrorHook=true, OsPostTaskHook=false, OsPreTaskHook=false, OsProtectionHook=false, OsShutdownHook=true, OsStackFaultHook=false, OsStartupHook=false
    OsRTATarget: OsRTATargetName=VRTA, OsRTATargetVariant=MinGW
    3 x OsTask, all with OsTaskActivation=1, OsTaskSchedule=FULL:
      OsTask_ASW_PeriodicEvents: OsTaskPriority=1
      OsTask_BSW: OsTaskPriority=3
      OsTask_ASW_SporadicEvents: OsTaskPriority=2
    OsTickIsr (OsIsr): OsIsrAddress=Interrupt_1, OsIsrPriority=IPL_1, OsIsrCategory=CATEGORY_2
    OsTask_Startup (OsTask): OsTaskCanCallSchedule=1, OsTaskActivation=1, OsTaskPriority=4, OsTaskSchedule=NON
      OsTaskAutostart: OsTaskAppModeRef=OSDEFAULTAPPMODE
