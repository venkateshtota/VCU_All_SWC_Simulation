AUTOSAR XML (schema 4-2-2)
package /RTE
  module config Rte
