AUTOSAR XML (schema 4-2-2)
package /Bfx
  module config Bfx
    BfxGeneral_0 (BfxGeneral): BfxRbOptimizationMcuExtract=0, Bfx_VersionInfoAPI=OFF, BfxRbOptimization=NO_OPTIMIZATION
    BfxRbMemoryLocations_0 (BfxRbMemoryLocations):
      bfxRbMemLocClrBitMasku16u16 = NORMAL
      bfxRbMemLocClrBitMasku32u32 = NORMAL
      bfxRbMemLocClrBitMasku8u8 = NORMAL
      bfxRbMemLocClrBitMasku64u64 = NORMAL
      bfxRbMemLocClrBitu16u8 = NORMAL
      bfxRbMemLocClrBitu32u8 = NORMAL
      bfxRbMemLocClrBitu8u8 = NORMAL
      bfxRbMemLocClrBitu64u8 = NORMAL
      bfxRbMemLocCopyBitu16u8u16u8 = NORMAL
      bfxRbMemLocCopyBitu32u8u32u8 = NORMAL
      bfxRbMemLocPutBitsu8u8u8u8 = NORMAL
      bfxRbMemLocPutBitsu32u8u8u32 = NORMAL
      bfxRbMemLocCopyBitu8u8u8u8 = NORMAL
      bfxRbMemLocCopyBitu64u8u64u8 = NORMAL
      bfxRbMemLocGetBitsu16u8u8u16 = NORMAL
      bfxRbMemLocGetBitsu32u8u8u32 = NORMAL
      bfxRbMemLocGetBitsu8u8u8u8 = NORMAL
      bfxRbMemLocGetBitsu64u8u8u64 = NORMAL
      bfxRbMemLocGetBitu16u8u8 = NORMAL
      bfxRbMemLocGetBitu32u8u8 = NORMAL
      bfxRbMemLocGetBitu8u8u8 = NORMAL
      bfxRbMemLocGetBitu64u8u8 = NORMAL
      bfxRbMemLocPutBitsMasku16u16u16 = NORMAL
      bfxRbMemLocPutBitsMasku32u32u32 = NORMAL
      bfxRbMemLocPutBitsMasku8u8u8 = NORMAL
      bfxRbMemLocPutBitsMasku64u64u64 = NORMAL
      bfxRbMemLocPutBitsu16u8u8u16 = NORMAL
      bfxRbMemLocPutBitsu64u8u8u64 = NORMAL
      bfxRbMemLocPutBitu16u8u8 = NORMAL
      bfxRbMemLocPutBitu32u8u8 = NORMAL
      bfxRbMemLocPutBitu8u8u8 = NORMAL
      bfxRbMemLocPutBitu64u8u8 = NORMAL
      bfxRbMemLocRotBitLtu16u8 = NORMAL
      bfxRbMemLocRotBitLtu32u8 = NORMAL
      bfxRbMemLocRotBitLtu8u8 = NORMAL
      bfxRbMemLocRotBitLtu64u8 = NORMAL
      bfxRbMemLocRotBitRtu16u8 = NORMAL
      bfxRbMemLocRotBitRtu32u8 = NORMAL
      bfxRbMemLocRotBitRtu8u8 = NORMAL
      bfxRbMemLocRotBitRtu64u8 = NORMAL
      bfxRbMemLocSetBitMasku16u16 = NORMAL
      bfxRbMemLocSetBitMasku32u32 = NORMAL
      bfxRbMemLocSetBitMasku8u8 = NORMAL
      bfxRbMemLocSetBitMasku64u64 = NORMAL
      bfxRbMemLocSetBitsu16u8u8u8 = NORMAL
      bfxRbMemLocSetBitsu32u8u8u8 = NORMAL
      bfxRbMemLocSetBitsu8u8u8u8 = NORMAL
      bfxRbMemLocSetBitsu64u8u8u8 = NORMAL
      bfxRbMemLocSetBitu16u8 = NORMAL
      bfxRbMemLocSetBitu32u8 = NORMAL
      bfxRbMemLocSetBitu8u8 = NORMAL
      bfxRbMemLocSetBitu64u8 = NORMAL
      bfxRbMemLocShiftBitLtu16u8 = NORMAL
      bfxRbMemLocShiftBitLtu32u8 = NORMAL
      bfxRbMemLocShiftBitLtu8u8 = NORMAL
      bfxRbMemLocShiftBitLtu64u8 = NORMAL
      bfxRbMemLocShiftBitRtu16u8 = NORMAL
      bfxRbMemLocShiftBitRtu32u8 = NORMAL
      bfxRbMemLocShiftBitRtu8u8 = NORMAL
      bfxRbMemLocShiftBitRtu64u8 = NORMAL
      bfxRbMemLocToggleBitMasku16u16 = NORMAL
      bfxRbMemLocToggleBitMasku32u32 = NORMAL
      bfxRbMemLocToggleBitMasku8u8 = NORMAL
      bfxRbMemLocTstBitMasku64u64u8 = NORMAL
      bfxRbMemLocTstBitMasku8u8u8 = NORMAL
      bfxRbMemLocTstBitMasku32u32u8 = NORMAL
      bfxRbMemLocTstBitMasku16u16u8 = NORMAL
      bfxRbMemLocTstBitLnMasku64u64u8 = NORMAL
      bfxRbMemLocToggleBitMasku64u64 = NORMAL
      bfxRbMemLocToggleBitsu16 = NORMAL
      bfxRbMemLocToggleBitsu32 = NORMAL
      bfxRbMemLocToggleBitsu8 = NORMAL
      bfxRbMemLocToggleBitsu64 = NORMAL
      bfxRbMemLocTstBitLnMasku16u16u8 = NORMAL
      bfxRbMemLocTstBitLnMasku32u32u8 = NORMAL
      bfxRbMemLocTstBitLnMasku8u8u8 = NORMAL
      bfxRbMemLocTstParityEvenu16u8 = NORMAL
      bfxRbMemLocTstParityEvenu32u8 = NORMAL
      bfxRbMemLocTstParityEvenu8u8 = NORMAL
      bfxRbMemLocTstParityEvenu64u8 = NORMAL
