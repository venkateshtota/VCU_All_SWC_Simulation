AUTOSAR XML (schema 4-2-2)
package /System
  composition sw component type TopLevelComposition
    4 x component:
      CPT_ComSWC: type=ComSWC
      CPT_MemSWC: type=MemSWC
      CPT_SystemSWC: type=SystemSWC
      CPT_ParkSWC: type=ParkSWC
    connect CPT_ParkSWC.PP_ParkStatus -> CPT_MemSWC.RP_ParkStatus
    connect CPT_ComSWC.PP_ParkControl -> CPT_ParkSWC.RP_ParkControl
    connect CPT_ParkSWC.PP_ParkStatus -> CPT_ComSWC.RP_ParkStatus
