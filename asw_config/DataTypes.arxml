AUTOSAR XML (schema 4-2-2)
package /ApplicationDataTypes
  app type ParkState: category=VALUE
  app type KeyStatus: category=VALUE
package /DataTypeMappingSets
  data type mapping set DataTypeMappingSet
    data-type-maps:
      application-data-type=ParkState, implementation-data-type=boolean
      application-data-type=KeyStatus, implementation-data-type=KeyState
package /ImplementationDataTypes
  impl type KeyState: category=VALUE, base-type=uint8, sw-calibration-access=READ-WRITE, compu {0=KEY_OFF (CompuScale), 1=KEY_ON (CompuScale_0), 2=KEY_STATE2 (CompuScale_1), 3=KEY_STATE3 (CompuScale_2)}
