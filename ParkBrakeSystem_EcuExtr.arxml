AUTOSAR XML (schema 4-2-2)
package /ParkBrakeSystem_EcuExtract
  system EXTR_ParkBrake: category=ECU_EXTRACT, ecu-extract-version=1.0.0, system-version=1.0.0
    system mapping SYSMPG_ParkBrake
      data-mappings:
        data-element=CPT_ParkBrake_FlatView.PP_comParkStatus.DE_ParkState, system-signal=ParkStatus_bool
        data-element=CPT_ParkBrake_FlatView.RP_comParkControl.DE_ParkState, system-signal=ParkControl_bool
      sw-mappings:
        swc to ecu mapping SwcToEcuMapping_0: ecu-instance=ParkBrake
          component:
            CPT_ParkBrake_FlatView.CPT_ComSWC
            CPT_ParkBrake_FlatView.CPT_MemSWC
            CPT_ParkBrake_FlatView.CPT_ParkSWC
            CPT_ParkBrake_FlatView.CPT_SystemSWC
            CPT_ParkBrake_FlatView.CPT_ComM
            CPT_ParkBrake_FlatView.CPT_NvM
            CPT_ParkBrake_FlatView.CPT_EcuM
            CPT_ParkBrake_FlatView.CPT_BswM
    root-software-compositions:
      root sw composition prototype CPT_ParkBrake_FlatView: flat-map=ParkBrake_FlatMap, software-composition=ParkBrake_FlatView
